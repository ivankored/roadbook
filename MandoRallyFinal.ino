#include <BleKeyboard.h>
#include <esp_bt_main.h>
#include <esp_gap_ble_api.h>
#include <esp_bt.h>
#include <esp_system.h>
#include <WiFi.h>
#include <WebServer.h>
#include <Update.h>
#include <Preferences.h>

BleKeyboard* bleKeyboard;
Preferences prefs;

// --- Pines fisicos fijos (no cambian, es el cableado real de la placa) ---
// Variante con las palancas en el otro sentido: "abajo" corresponde al
// pin 0, y "arriba" al pin 2.
const int PHYSICAL_PINS[5] = {4, 5, 3, 0, 2};
// Orden: Boton1(arriba), Boton2, Boton3, Palanca abajo, Palanca arriba

// --- Perfiles de mapeo: 3 perfiles guardados, cada uno con nombre propio y
// una tecla/accion asignada a cada uno de los 5 botones fisicos. El
// catalogo de teclas posibles (KEY_CATALOG) esta mas abajo, junto a
// enviarAccion().
const int NUM_PERFILES = 3;
int perfilActivo = 0;
String perfilNombre[NUM_PERFILES] = {"Perfil 1", "Perfil 2", "Perfil 3"};
// Por defecto, los 3 perfiles arrancan con el mapeo clasico de musica:
// Boton1=Play/Pausa, Boton2=Vol+, Boton3=Vol-, Palanca abajo=Siguiente,
// Palanca arriba=Anterior (ids 1..5 del catalogo, ver mas abajo).
int botonKeyId[NUM_PERFILES][5] = {
  {1, 2, 3, 4, 5},
  {1, 2, 3, 4, 5},
  {1, 2, 3, 4, 5}
};

String btDeviceName = "Mando Rally Final";

const unsigned long TIEMPO_COMBO = 5000; // 5 segundos
// Margen de tolerancia: si al mantener un combo se sueltan los dedos un
// instante (por no pulsar los dos botones exactamente a la vez, temblor,
// guantes, etc.) no se reinicia la cuenta atras mientras el hueco sea menor
// que esto. Solo se cancela el combo si pasa mas tiempo que esto sin que
// vuelvan a estar los dos botones pulsados juntos.
const unsigned long TOLERANCIA_COMBO = 700;

unsigned long comboRebootInicio = 0;
unsigned long comboRebootUltimoOk = 0;
bool comboRebootEnCurso = false;

unsigned long comboOtaInicio = 0;
unsigned long comboOtaUltimoOk = 0;
bool comboOtaEnCurso = false;
bool modoOtaActivo = false;
unsigned long otaModoInicio = 0;

unsigned long salirOtaInicio = 0;
unsigned long salirOtaUltimoOk = 0;
bool salirOtaEnCurso = false;
const unsigned long TIEMPO_SALIR_OTA = 3000;      // 3s: salir manualmente del modo actualizacion
const unsigned long TIEMPO_LIMITE_OTA = 10UL * 60UL * 1000UL; // 10 min sin nadie conectado: salir solo

const char* OTA_SSID = "MandoRally-Update";
const char* OTA_PASS = "rally1234"; // minimo 8 caracteres

WebServer server(80);

// ======================= PAGINA WEB (PROGMEM) =======================
const char PAGE_HTML[] PROGMEM = R"HTMLPAGE(
<!doctype html>
<html lang="es">
<head>
<meta charset="utf-8">
<meta name="viewport" content="width=device-width, initial-scale=1, viewport-fit=cover">
<title>Mando Rally</title>
<style>
  :root{
    --bg:#f5f5f7; --card:#ffffff; --text:#1d1d1f; --sub:#6e6e73;
    --accent:#0071e3; --accent-2:#34c759; --danger:#ff3b30;
    --border:rgba(0,0,0,0.06); --shadow:0 8px 30px rgba(0,0,0,0.08);
    --logo-filter:none;
  }
  @media (prefers-color-scheme: dark){
    :root{ --bg:#000000; --card:#1c1c1e; --text:#f5f5f7; --sub:#98989d;
      --border:rgba(255,255,255,0.08); --shadow:0 8px 30px rgba(0,0,0,0.5);
      --logo-filter:invert(1); }
  }
  *{box-sizing:border-box;}
  body{
    margin:0; background:var(--bg); color:var(--text);
    font-family:-apple-system,BlinkMacSystemFont,'Segoe UI',Roboto,Helvetica,Arial,sans-serif;
    -webkit-font-smoothing:antialiased; padding:28px 16px 60px;
  }
  .wrap{max-width:520px; margin:0 auto;}
  header{text-align:center; margin-bottom:30px;}
  header img{
    display:block; width:150px; height:150px; margin:0 auto 6px;
    filter:var(--logo-filter) drop-shadow(0 6px 18px rgba(0,0,0,0.18));
  }
  header h1{font-size:26px; font-weight:700; margin:0 0 4px; letter-spacing:-0.02em;}
  header p{font-size:14px; color:var(--sub); margin:0;}
  .card{
    background:var(--card); border-radius:20px; padding:22px 20px;
    margin-bottom:20px; box-shadow:var(--shadow); border:1px solid var(--border);
  }
  .card h2{font-size:17px; font-weight:600; margin:0 0 4px;}
  .card .desc{font-size:13px; color:var(--sub); margin:0 0 16px;}
  .switch-row{display:flex; align-items:center; justify-content:space-between; padding:6px 0;}
  .switch-row .lbl{font-size:15px; font-weight:500;}
  .switch{position:relative; width:51px; height:31px; flex-shrink:0;}
  .switch input{opacity:0; width:0; height:0;}
  .slider{
    position:absolute; cursor:pointer; inset:0; background:#e9e9eb;
    border-radius:31px; transition:.25s;
  }
  .slider:before{
    content:""; position:absolute; height:27px; width:27px; left:2px; top:2px;
    background:white; border-radius:50%; transition:.25s; box-shadow:0 2px 4px rgba(0,0,0,0.2);
  }
  input:checked + .slider{background:var(--accent-2);}
  input:checked + .slider:before{transform:translateX(20px);}
  .profile-tabs{display:flex; gap:8px; margin-bottom:12px;}
  .profile-tab{
    flex:1; text-align:center; padding:9px 6px; border-radius:10px; font-size:13px;
    font-weight:600; background:var(--bg); border:1px solid var(--border); cursor:pointer;
  }
  .profile-tab.active{background:var(--accent-2); color:white; border-color:var(--accent-2);}
  #profileNameInput{width:100%; box-sizing:border-box; margin-bottom:12px;}
  .profile-actions{display:flex; gap:10px; margin-top:14px;}
  .profile-actions .btn{flex:1;}
  .slots{display:flex; flex-direction:column; gap:10px;}
  .slot-row{
    display:flex; align-items:center; justify-content:space-between;
    background:var(--bg); border-radius:14px; padding:12px 14px; gap:10px;
  }
  .slot-row .name{font-size:14px; font-weight:600; flex:1;}
  select, input[type=text]{
    -webkit-appearance:none; appearance:none; border:none; outline:none;
    background:var(--card); color:var(--text); font-size:14px; font-weight:500;
    padding:9px 32px 9px 14px; border-radius:10px; border:1px solid var(--border);
  }
  select{
    background-image:url("data:image/svg+xml;utf8,<svg xmlns='http://www.w3.org/2000/svg' width='10' height='6'><path d='M0 0l5 6 5-6z' fill='%236e6e73'/></svg>");
    background-repeat:no-repeat; background-position:right 12px center;
    min-width:170px;
  }
  input[type=text]{width:100%; padding:12px 14px; font-size:15px;}
  .dropzone{
    border:2px dashed var(--border); border-radius:16px; padding:26px 16px;
    text-align:center; cursor:pointer; transition:.2s; background:var(--bg);
  }
  .dropzone.drag{border-color:var(--accent); background:rgba(0,113,227,0.06);}
  .dropzone p{margin:6px 0 0; font-size:13px; color:var(--sub);}
  .dropzone strong{font-size:15px;}
  .filename{font-size:13px; color:var(--accent); margin-top:8px; word-break:break-all;}
  input[type=file]{display:none;}
  .btn{
    display:block; width:100%; text-align:center; padding:13px 16px;
    border-radius:14px; border:none; font-size:15px; font-weight:600;
    cursor:pointer; transition:.15s; margin-top:14px;
  }
  .btn-primary{background:var(--accent); color:#fff;}
  .btn-primary:active{transform:scale(0.98);}
  .btn-primary:disabled{opacity:0.4; cursor:default;}
  .btn-secondary{background:var(--bg); color:var(--text); border:1px solid var(--border);}
  .progress-wrap{
    height:8px; background:var(--bg); border-radius:8px; overflow:hidden;
    margin-top:14px; display:none;
  }
  .progress-bar{height:100%; width:0%; background:var(--accent); transition:width .2s;}
  .status{font-size:13px; color:var(--sub); margin-top:10px; text-align:center; min-height:16px;}
  .status.ok{color:var(--accent-2);}
  .status.err{color:var(--danger);}
  .toast{
    position:fixed; left:50%; bottom:28px; transform:translateX(-50%) translateY(20px);
    background:rgba(28,28,30,0.92); color:#fff; padding:10px 20px; border-radius:14px;
    font-size:13px; font-weight:500; opacity:0; transition:.25s; pointer-events:none;
    box-shadow:0 8px 24px rgba(0,0,0,0.3);
  }
  .toast.show{opacity:1; transform:translateX(-50%) translateY(0);}
  footer{text-align:center; margin-top:8px; font-size:12px; color:var(--sub);}
</style>
</head>
<body>
<div class="wrap">
  <header>
    <img src="data:image/png;base64,iVBORw0KGgoAAAANSUhEUgAAAUAAAAFACAYAAADNkKWqAAB39klEQVR4nO19d7x2SVHm8977hQmEYWDICAKDpCEjknYBJUlSzKwKJtx1FQOrKIiryGKAXWFVzLqKiiiIioooSlLJKFlhBslhCAMzzDdfuPe++0edmq63blV19Tnnvfd+TD+/37n3vH26q6tTdVVHoKOjo6Ojo6Ojo6Ojo6Ojo6Ojo6Ojo6Ojo6Ojo6Ojo6Ojo6Ojo6Ojo6Ojo6Ojo6Ojo6Ojo6Ojo6Ojo6PjIGKx3wx0dHSsIGqTyz3j4iqCLgA7OvYeCwAbKO1vqZ4oHD/8e2d4OkagC8COjoOFQwA2QQKSsQ3gFLoGODtkbwKs9kgL1HujHSP80nhv5WnOgp6b3lRY/HB+t/A6Jq+9uDcq4a1wUZxePcrUKcnXGGTyorVOcDpaeJBhdbzXBXAfALcBcBMAVx/crj48h1E0xCWALQDHAVw+PJ8D8FkAFwH4BwBvGPxvN/JZS8OOeNfforKfKgNa0Fo2K2BVnAmxm/5tVX4Y7l4cHv0F7EZSi38uRJkX8WR9t3iU6dPhxyIrjHS6PN4zsPIpW65W3BFfVpxjOoUx38fQytBkf4dAmtzPA/jhJB81vAPAneCbz1Y91fmqy7CGrAC0fk8SWEmky3nDcNMZaRFiP3o8woKVGZYWYsVvZd4YWLy1FIKXB9lwXgXT37M0M7x7Y0qeILPC1ujrsSctEKKy1t+YDx7T8viP+MrwLOOSfHjCo0arxo/8zhbTPUHa2hUAToI0vG3YaednZ/C3NYQ5MTw3BXCz4btWZlp4z7RfmQ4vjFWnLStTvs8tEK30aT6WQDF9okogYTXgqOJ4PY3FqNUgvMYbaW3WuyfAIj/ZhucJdSs+K2zkz+qMPMEz9nctPsmnV6G00LNoRfxY7lEvHvGcgY4nU1esbzU+5KQFm6g3BnDb4fthlPG+TeFv4YTfEH657V4dwF2Ef/nf4lG+1zQlq7OVblFYq25Y9Gt0pkDLg13xZHsMRqSNZTPGgixo61vEh+fuCZyMyetBh/feOf5IwEfCZql+ezx4+ab5ymh9HiQfsr7UaER5rXnQZpqVrmznKFGrD1b4qA7W8tELuwAJLQC4K4BzQZqchOzUos6W/0vr7V7DfxaiUZ2RyAhw7T+bB62yoEXTz9CJ2h4w8LchfyQZa/Gb0YoirTCik9ECW+Os0awJsRZ4QsrTQLx8qWnwnqC1fkdCoKYBR/4sHjNhvPhkXvHvWh3JmFsb6ntGm5X0tT8t2AHggSKuTcRCRsavzc4N0JgiQALwsPiesdQ0Xzofrc5eCt2aVlyrB54fTaNWf5k3/Z7q5HWPnpH4WWHB7154/d2iW2uQLQ3ViqOWlgxND7V8sOLdcPxaWlFN62NYAq7WUcn6YNHy6HtlkuGtBtk4MxqoB6tDP4RiomoTFMa7R8v6znm4DeAI6tqaphtZMqxV3hY0m3wKfh2KEKWT4+GxycMj6FvafVSGWijXykHHZckYs1OwJkE0A963iIHotycYvIoQaQcZEyfi16vorQKyRj/r7nUOUUdi5eHScItoWelvFU61ijqmMlvxWDQzvFk0WPCdGtxvAzJNDyl+ozgiLUXm+RZowuJ8g49MB+l93wFwNQB3QJlkiRZGZ9qnzqMtANcCcDZoAmYHtvZqhY94bw3jIStjtJ+FZwK3aFEtjFnfa2qwhRbBXKOjG7vkSQvCseauxVNLLxrl0w7sxmeZYq0mu2c6RSZVJqzky3LXZlLEc20XhFWe3HhPgTSzxwH4ewD/CuDbQY38MNrhtSNuZ3cGCRFvvZ6lcevGrMuX039nFW6M+aj9HAblxU0AvAbA6wA8EcB1QEKRBaE2jT3LMaPQeH5q7UXnm/VuxelGontA/Wwk/Fi9qCWdLbpAnpeWuC2atTh02DE8jQ23149GJow3c+mlPetvTFl5/G2AGrQUbA8F8EqURncK1OAfMXw/KsLW+NWQcR8Z3J4h4uE4d7B7+cuO8yyxe7nM1vD/z4c4WKut5bv+pvPq6PD9OgD+BavC6f0AnjR8YxpHsDpTLfPNiifT1vaiLZmELLQ0hKxwnJqIuTIhnVFBnFZ+wfg+lu8oTJaelwYvXWP43Ovyq9HgyYYzRDofCeAVKA2a19QdBwmYzwG47+D3DOyu11Y+asj4mcZLYAtAKfSWxjfttjPwuY2iiX0AwDkgASiF4Ji85OU51wJpfsshb06C1i4yLx8F8OODP6B0MLrTYLotcsHD1PqieagSlX7mZCRTgedK/Jz81mjq/IrS5NHS36zvUfgxafB4zfC4V3k/plGzZgIAdwPwpygNmBcW8yLjU6CGvgPg4sE/UGZbMxrN5uCfhQjjMIAPD7TZ9JbCzFsA7WmFzPspkPDeAXAPrGJziJcFYqTNSv43AJwFGhZg4belHinE3wMaOuD08kQJw6sT+n/tu+VPYkz9dxtopPZXiVa+t/gf84yl2aqyR/k3Z1pay0Dz4fkfS1v6mzO9mg6M95o5yv42URrkNUDbz05gVfBpwcIa1fHh2wdBuyyAIgStOmMJPMYtATwKwLNAQuMUVnd+bKO+C8TS/rYEPRZQfwjgG0GCUGq8wOoQgDUDzXnGGvOfD3FeYfAozXEpCF+DMssd5VlLuXvlO6U+rWinYxpgVBHX0RDmfjzeozR5BaDdYXxbV17ouMbE6/nLlK8V1jJ9anlmfZuSX4cEnUcAeDuKALHMT/mbGzubeu8AcIOBFgu4BUiQ8BghYwPArQE8FsCvgw4puEzQP4kiAL1xPmtM0NIApRDk7XFSs/13AC8G8CMA7o7dApGFoSwfzrffGugcw+5tehaPWyidyzFQZ3ONgRbPqHMcc8iNqP1m6O8SgEgEavE3Jy2MCDPnw5ir8NaRV7Xv3phMtpJYeeH5GWs5ZPjQNPSAO5t8AA3Q/zaKUODxPT3ZYGlZLAQvH9zegjLgL01q/n1PAE8HzZJeYdA7gbJ8xNKmIuFiucvxP/mcHJ5txcM2SJD/Gmj88zzBv54c+sUhzOXw9yh7wpjHUbnjePBAc4EibC0hBeEGzFd3Mu36SsjKJt0k0xEjcN6zFVrHqXnLNhSLb6/xALvjMgdJgzTUeKgJkUxhZ/JA8+7FE6WnhTedt7Ww2bR5tLRbJPweDuB9KCYcC4VWgSM1wb/DqhZ1RwBPA/BWrGqVcjZZj/Vp2ll3bS5viXf5W48RskDUgv4jAH4BwJdjVZj/KIqmGmmkljCWAvkK4e85oP3KgD1TnG0bgF+HMm1Th1txYHjrd7SbhwV2rwPS4a1vck2O/BbFY8Ur47D8ebDir8Ut47B4len0/GSh80zy4fmXaMmHrN8x4b3vlns2z7jS8/jVjwN48vDtJFbHoTgu+TsT3xZIuP4OaNnMowE8BGWpCJu0lqbNadsx4tTIllumnHSbYyG1QFmWA9C43W+D9ic/CyUdnhyQ6dBtXeYh+9sEdRLfCuCdgsZS0NBhNf8WH1aYyK/5XUvdORFFHjViS2BKWGGsjMgKwVqjnCq8mAePRovQ0JXF62TGYAyNOeKt0fLcpdsmSAg9D8B/QWno3mEfrXwvBppykoM1PWkdSf8tHZT3rSYErHZiCS5Nl7U3OVHE7h7vkk5L3nHn8WmQ1vxRUH7tKHpWnkR81JQqTdvk+ZDxoaaBVYkqP7ISej09sJr5YzU4Ga5Fa9VhLfcspmqz1nevclhCOqN5W3S9fIjKOaqg3vda/PpbrRPl9yXKLoslSsNu1Z49bIIEnhQchxHnj4fWuqXbnJWeFo2Q+WchznQteaD5bE3rJqhMPgHgUtTrcy0e6c9Teiw3M6+tvcBcmbzfsiCWxnf2A+VHu0fhpV/pP5v4MRpbhifPXdOR/1t5kPFYeZ/VkjKar8eDJ1CjcJIPi08dbgc+WsuP43oeVs/Ki+jVGqFV53jmV89sWrxY8Vnlamlxlp9M/uu4au68hOcIdq/da4VXN7nDeD5oRpwFb41WDVOE8pWQywUiM83TJGqaYA1e44o0Gs3nmMaf5UuipknofIn48+B1NNmwNY28hR8vTyO+ahof/9fCr5afGrouML3Xgu7KOMehWdMsvToW8SD5l+9RA5XhvI7AqveRdmYpBJbWn2krUacbpctSnDZAs8N/PfjfrsSn3XS9k25W+hD81vQXG8rBQi2D9O9Ig/LoLLC7kL13zZfXE1uabOTO77V4tHvt91hN0GtgGrKBWHQybjU/mfKMrAaLvrYONK2MMJVlehjAx1B2L8iGlqmTWvvW3yxtXL9HWpD+brWhzOy05MNTHDwh31IXLW3UE7L6m1wovQE6ZOJtKJq5Vy+jNm/VL6seZDTlK8N6x2Fpz/rdMhUsYVajN0a7iRpaFK/XU0Q9iBWf9FfrCCxYBWQVXI0vdpd5r+PkiuhVpIg3r8J7/ETaUASrvrR2GjKNL1K8ZIQe+5VuUeOT75mOgR9enqJ3g7CmxPt4D4t33sYmT12x1gCygMx0mhGPjFY6keD/w4FHb1KqBV6Hr2VEpJ0u5Is1XlLrfbUElhF4ZowXzkLWj+TJ++b5aYHHT4ZP7T/DSyZva7SZRms5tfAV8crIfpsKPrTz+qBFuOegCBZdV6K8GgtNlwUe/2cBF+Fy0E4K3tXBAmQTwJmgc/+O2EEBFAEL7F6SYykRU9PM0GUs034SdGfJe7A6/if/S/50h+7xnK2vYRhvDHBMg7AEnJUxY0ywjJ9WgdiCjFZZQ00jlPTGmC5emAytVvpeGXu/M2U/tZPZAWlOHwXwcgBfBxIGLem1BEKrkJSz0HKJyUnQiS3vH54PgA5H+Czo9JlPAbgEZfuZFoBHQQuKrw1as3c2aIvezUH7jW8B4IYgIclYoiwJiqybKI8tM5PhTTZxmMOgbYjvgy38LHhaaGQhWILSo7mCQwZTGe3P81erILWKZ/UCGmO0I6sHHKvxWHQzYbRZ5uWl1+tF9LKITAMv36M8aNXmWzVm5kvTs9zl7z8FCUDruxVev1uNmt+9BrZEMVkBMnPfCuD1AN4I4M0gwfc5I/wcOBMkAC8AXbp+z+H96sIPn3wtd0GNKRMJLx85n/4GJNCPoHQOtbBRHBKZ9hFhafUMUzPEjChBs0UdbzFxs2ZnC2qmYFabibTWTJwtaIlLxhdpRFoDmApL+GTqDf9fgBrZ9UBm8LWxe3FvrQP10m0JRR7X4i14J0DC7uUA/gLAu0F7YyX0FsKl+G3ltcWvxZu+ZW4DdAT/l4P2/94LlB/MN09Q6F0fmYlRyZ/0qzv5JYD7g3abHEHRbOdApl3rOr+rPmkBGAmhjICyetkMvRbhl4WsyDWt0vvmCSsvjEcno9ZH8PIqy0OrYJmzE8xqqrKsWoUgh1+ATK2TAP4EwNeCGp13f4Wmb71LXuTsJp/7twVafvOXAF4Gmu3kMNIMlrO4Fg8t0DtSgJJ+Fmg8UcK4CYAHAfh6kIZ41uB+BVYvOtKdhUam/vGY5/tAuz+OC3+eFl3DHJqq5GHBji1ExwiqmrYk3WC4rwMyfjNjRkLTku46fsu99q0FkRZqIerNM9rsOmFpQR5/h0CN/yEgocQLcS2/VjwMq/PbRjFxPwyacX4BSAAyWJiwwIvi4Hi+EsCXgCZuzgWZrXyyMgtR1treAODZKDssNL8sYLgz4Dp5Svi9PWiI4NHDO4bvsqOoKQVRZ8Xb334FwPeAxi9PGvkQaeIW5qhzK/HUZqXmgKVhejb7HMI1y5PVy401QyO+La046z4mbZbGmzUjvd8WLx7NdWjzUdzWNz37qjWWGu+6bFjwHQJNVvwqqHF/VISTmp6+9MgSGizA7gg6Kj+LC1EmfPRaR/kfKEJPjk3ugIYH3gE6t+9bAXwf6EY8YHW5igetMEiTV2q6TIdpSg3YK1NLw5R1WvLQ0l4tGldGYj3ZQwc3lLsOV/utG77lxqgdWOp9a01jLY7MsVNj+LS+Rf6zB0BqepomnP979bCm08Kz/sYzpQBwP9CMavakZdl45f8t8X4x6FKjm4o4D2P1LD0vb/W3TRQT9BeHOD4P0pJOqOc4yn0cF4MmOji93nmMnBe3x+qsMN+NcmR4mL+rAfhuAP8m8kIeo+Xln3ec1ymUI7Geo/jS+SPrsCcrdJhaPW5qD9nGWmtoXiLGPBFfLYnM8tKSD+t+xsY1JZyGRS9Lf2peWfFaNDWffFbfVwP4DPxj3DMCcBtlLd4lAJ4J4IsEL2eCBMxR4XYN0Jgjzz7rcUfJO48f3nSgbwkReeIzC5PfGGhZ9xZzfWfT+bagwwcuAp3991CUU5o3UPb/noGiHV4DwA8BeK/Iky3UhZ7mnc8i/PwQ5vko5cOCu0VOeKjVkVT92quGva5nbBoyhdCSsQfhWSevTHsdHVxGs7fiZ7AG9i0oQo9PbokO9bQEoDzc9PdQLjLneHinBuMGAP4nivb0TYO7vh9EpoEXM/MBpByn3vbGC5tPDH7uI2h7dZqF8o8b6XsngJ8AcGOVJhaIzOO1ATwVRYDJg1231eMJQX2/yl+CtF5eEO5ZkjK/au1U+x1VF0+nBqrDywzwMiNrymfjr2X63Gmc079XyabyPIa3MRqALjvWYAC6DOg4ykVBtaPn9XgV+18C+A8A3yDiZSEhBd8XgzTDj6MImDeijLfV+D8K2iNraVnyYeH4iiGMdWG7pLsJ0uTeg9Wtd/KY/I+CDj/lcb9DIvwRFI3wLqCTsDl/TqBsvfNOrpb5zvHxfSF/DTK3+QQa3ZlF9SaqL1MsvXSl28tGLcPMxcMUXtaRJ2GhqPRrP9qN3+cy+TNhosrr0ffGjq1vULRkGrmh8zja41D21/K4XU1LkY/U+n4NtJ0OKObhIRSN7oYAfg50vh2H4btDvleE88aJmc5XYnWszRPSLDweO4TztsItUATXo7E6him1Sb5Bbgk6nurHULQ/mf/csWyALkFnbfAYVi92quWvFoJ/BdrFIidmvPRY9Ufui/bqvBVe04VyNz/uxTMmriiTrMYWubXwBOf/nM8cJmamMuxV+dbSCpQxMUtoQPnndzb1vgmrDdya0NAaitSMeHztQgBfNdBkDU1OrBwFCYuPoAiXy4fwWyCt8ZyBN8tElY0XAF440OF7iD1Tcmfg7Rzsbvww4gBI09rBbuHK6T+FIrRfiyLgtVCRQuouAP4Zu4WgpfF5kyUsBP9goGlpswxd5mw6s+a4idV8HWPRLTgiHalXWa0e3GvAEb1aXDV/VkZ5fOjMmVvA7OWTzTcvv/abf5n38hJtCSkMPb45zL1RBJC+CU03Pn1xz0lQQ2at5HqCH3kiC8fzT4ImX3h0StB49uBX34XLaeYTpBegqzP51jV9wZF8eCLm/wjePM2b8/O2A+3j8E3VpaD9HUM4vuLTah+cpiOgiRjW6Piyqdpsu4ybO5wnC5pc1laajmD3TXwMPaGi+Ze0vHYwqbFZftYlYDKJiRpdbQxBf8/QnjtN2TBWODjvB+nhnpvHnG4GunLyjwB8DYDrYhVHQWauHFPjxngB6OJyrflZjU8KFV5awgLg11CExyEVxxkgc5c1FzmWxvHyJMVdhjB6MbFMO5uVP4tVs1DPoLJ2enLg9W6KP1ln+WFN9edRNEs5cWFplh8HXZHJwlkrCxD/5TDAj2D3UiGpcUflwGk6DuAxAz3mXS7h4WEExtVB2/meBtJEHzi4126aq7W3dINB0t9cAmHdcbVk0hi/6+B/TP54YdBAY2yd0N+5gvJA+8uw2kg+Bto8/0TQAL3WArmh3AJkckpNJnpk4+erIo+BFgADq6Ypx3lX0D2/LPi0OSknL16FokHJdMu0Hx7SfR5oFwkLBC0gWPidGNz+Hqtb6nRZsml4CDQj/XGsCrltRVuOef7vgQ6b+7qcZFnKe1AAunD+YpE/Vl57wp3XOB4Dbc9jHrSmdyPQEMcLUK455eeiIb3yzMTIQtXlwe/NDbwWZl3CJnpatM7M0pcx/NfCjdWMkaC91/k9Jg+0pvK9WDWlWBvi53OgKyifBtKAuOHdAGW/rdRyMuYXN9TPAnjAQE8eOMpm7/UA/DvKRAHzyKavFFJLAN8+0DhT0GCNid/PGvLhOwXv+lDTUyIeNhW/U+TbZoX2t4g8tWjL+4pZaz2EsjiaF3UfUg+Dy5A12duJfJJnGHpjmXKs9sTg/lkAdxJx3AQ04fMCAJ/E7rKU+f4nQxhrL3Ot7kP839MGNAeNOeLdLz483iT2m5+5H7lsZQEaA7sEq2NUPDh/HNT4pXZ0ErTE5Kmgk0WWWB37swbivZneT4FOSAGK1qZnVn8OtjC1ng+izEZn8OZG2mc30H59A+0XNNA9F8CjhnfWBDnNN0NZAym18WhmWK7VXII6tEcCeDFoEbvkUy/j0WOY3zjwYS0Or44Jeg1wKpZrorsYaE/BnLytK51z84gZ6WnaC+PdinsBEjjbIDP3/th9Uous+PxbX+bNJpe1hEJWcsnPKZDwvQh0GspbBC+bII3igaAFwFsgjU7vtdUdFmuNHwCZ8qxBSVOS+ec0XQNkOkLR4vRKsxEgU/mVgqYcP5VpPTXw/jAUwcA8MmSeHgbN/r5V8CxvupMdyjHQ2Ox3gIYm/gHl9O3DQ35dF7Tb4z+jXEav0wbsrh+6nBjyUFnpT6ZlZ3C/BMDdQZ2Fjg8qjAlPI7EkZkaTadV69koLyaTb8z9W48nm1dz5MBc9j05LHnJ+sAn737A6bhRpbXr8iM3D7K4EGc+/o2xnO2Pgh7WY/y54uBRkhmXRonW9tIHuJla3pNWev2qgfX2UZTCZ5ymgSYhrDeG5TBcoHdOZoDMQlyChWSsX+c7av16wvVT+Jc0t7N4iaO01TsmDbOWG8Z6N0KITxbWuRu0JLJ0pmXhHrTsy6LekbcpaRu3WEreVN5l4gaItXR3UqOUEgLVez3Or7T6wlrosAXwawB0GXlj4ccN94uCHx6T0khO51EJO4myAlsfwzKYcG5RjbmzWb4EWPzNtWZ5yjSB/ewyKMDmp6MnxPB6fvN9A+6jKfznzfubg53sG2syXHHvkGdpjw/9PgbbOWWUrhzY2QOXLE1t8tL8nAK2y1+5a8MllQ1y+J0DjtHoWXrcVr92kBQ0Sflr91uiMfXT8mXgsjBFQLUJoTJzet7E8tqZH8x/lIbuzucrCRg6YW729Fn7WN+nHWj/HY4SfBpnbQBng5xlHXtPGDesYaB0dN5haep6HVS3Tasws6N+GsrMkWkPLs7q86JgFs6UZ8yz061AubNeduaTNlyv9q8g3nf/sztoVL1rWu1t0ubP2dQ2Q2b4E7R6R+4hbBGDNGuCH9xr/xRB/dFCEzpcVtDSoKNzYxjTm+9xCoJYnmfDr9H9Qn2jJAX+7HmhMi7UNa/bW0wI94eJpCax1XYYi/I6gaFhnoZhrrF0tQXeJsF/PKmDBeP5AXy4v0WYfm3ZLAD8whNMamsxDFqwPRpkk8ExJuVD6cYpvq7HrLXjysAirM+L1kvcYwm0qeroOSz/ngoTyDlaP1co8Ubl7QpDT8vAhftaiMxsgdiVoPx6LhxpfXkFMbcBz5YeV4RKWsBiTT7oSjqG7rjIFytjfT4Mq8xWwtQLP7LU0B+vRi52XKPtnuUHwgP8foAg/qUl99eDfElIMFlJPxaqGZgkobpgXg5bvRGf4ySVCz8eqZmmZ/JyHHwAJHEnHW8cH0Ak3WrPUnQsL9H9UdKOy3lTx3HJIN/PbKgCj4RE9JKI1YbljprbBId3gLCFRCz+XQBlLY1diJ/Ixxy6XqXmWTUMLr608oRJGN8JbgmbreJwpGhuK3CxNRWsJepEva0UsiH8JRRCzJrEEmYVXQxGSXqNnWv+CouEwHTmuuYNinv3CEDcLOJ2fPK64AJ0yc6lKs84XOQHwMwMtqfXoMjgkaH8Wuy9Tl8JECt7vVrS9R04+yLx+pKCX1QIjs9gbCpDl/jjBc6j1yfeoUs+hHWEiDc2jx2tEfyzvY9M7B397yfPY8rQeHm/iiYZngyqn3J9qmXbW2J9l/npmMDeCV6GYu3L3wjNQxqb46CwWUt85+OGxLuthOg9FEXDW8VDMEx+YcMchX+TyEAbnGQtH1izluKI1RrcFEpS3HsJtKHqyLHjh8k9hVfP1zPYlaFfOedg9ESTpsta6AE3afAlKufOEy08k0mOVeWQJeCbxEsC7QGsnme9IDpkZ5rmPaZAbI8LVVO0aj3vZ6LXbVJ7GpG9MXsB5n1rmWuvYAG1n+hT8xuaNBVrvnmYgG8JHQRonz/TyUpfHYtUE52cLNDZ5HZEGnRa9kPvPsSrQrQXZ3OBfNoSxJj8YHN9ZoKs0WcurCfq/HcJHSgoLJL0FzzOrWbP81YGWdVSWnLU+CzT7ezFofSdAwk8KwT+CbdJbQwe1zs4Kq/OcT+WW2xPd+m01CJ2JGi0NovbNm6r2xjLGNvqx/GbW9EVptfiU/M+ZDp2nEe9WHk7NV9kwWOv4ftiVPzPGk/HPv1kD4IXGZ6IIv3uATHB9hBNrf780+NNHLPG71CLvgHJCs2x8emCexyEfN4TTExTyYdoPQdEs9c4WKQA4rd+jaFv1iWnzWkd9ZJjkXW6Vu48I75Uza/jfjKI5PnNw4ysDNkELpS9EGXvUnYYllL1ytrQ/KcB3QLPQ1sJ0q52mGmy2YY9prFPoTOUBioYnAGvCocZHlM8R3f14xvCj85DXnUmNxhoItyqzpxl4jUQK1+cOvLAGchi0qJn3q24pWqwFyplOr7xYm/llEafVMOUExfsAXFPkizdJwQKMZ6ajo6w4zk+AZtZZM9V3kMg0nAk6Dl8KT6sceFb5Ndh97qCENH+Pgq7qXIrw/3Xwxyf5AHSSC68t5HFgS3P2OjtvKMTTIrlMrWUxMn/W2pi0QJljEiHTUMekKzPTNVZAZNJQVdVnTKuXhzDcxsTJlf6HsNqgrcW8chGu9fDJIdqdtTmezXw3Vg8N5TG1Fww86AXFrIm8SoTx0sffrwk6EPWUoqUfPiPwGQMteUYgBE05rnhHwWOUB7zLgoU9L++xyoEnJ74C5RBUFkDWgu0rQALkcQHfkvYCwH0Nfi8HHZQAlUa+A4X50IdMZB/tX/7msd0/EvFH7XZUo/EqCv+OzNeMsMnMOHsJqgkSb3p8rACq+TczfUS+19I5lubYdEXhueE9AbmZvzmehw5x8lFbC+QONXiCCOfVcRYE39LIk1xU7dUJNjGf10j73kO4aGE1C6m/bKB7KcrkR9ROOU/+wKHzWpRLkBZD/h7F6sGy63yeP/DnTQ4tACzGXIyuhY/1bVmh0fJdx7HEauVcKj8Wbel36fir8aT5sOK2/GveFminZfnV79mwOq6x4RhW+B1Qxfu/oNnErxn8eXm8FOF0GVllJ+M8DLrk+6WgRsam0dVAGtsLBD8Sm4Pflwz0th2emC8MNP8IpHGw4GJ/3NB3Bj7eATolZRPF/Jf++fcpkGC4BHRM/paRZqa7M9D7OIA3Cb69Or8NGot935APp7Ba7lIZwMD3q0GTVsy3zg8OvwUyrT8N4I+xmsdLkPC7I0gQ8uEJW6AO58nDb84PWf4y3bqeW3VNd8aHQBdCPcPxv0LLa4xTwQmLKn0GugFEvOq4dCP3KskU/iy0CrJqITXSnBrvWHowaG5gt2BZFw5hd1lm4mYhUOsYx9SVoyjjjhY9/r2h/GSwAZ9nRlYh0WCBVeu0anxLHvn3XtUHK/5d9X4OASgzaaygmatBehrKnEIuo3HNKWDWIaRb6E5Ni1wky/Q2xbv+puOt5Te7Ww3Lilune1t803FDfWOT0Ipf/mbtRWo0WtvReW8N+2hLiB8e/New8koOSVh+Nd9waFvhtXkv08l86vj08WetkGnbEW5aY/TSsJKv69IA59YwmCZmoLsO3uZGjceDkgaPj9owRAeBDxeVJq41vKHfOwpa2sGuTn8dAnAvhF9LHJamY4WfyndGU7EqcSbeiF9LU9KaQw1za+BRXlwNtFD5OOKTO5bYvRZOj/fIAW42ybTmxjSkliDpQdCojTEtDTepXW0Y4TR2QKceXwI69v+kCsOmvB5/OwfA7VFOWOE80lqY/s/hpXC16ofuoHSa+Rv7k9rXjhNGl5VFD8ZvXUZW57AATdh81OBNQ7eVK+PSkyAtgsZqkJa7x4zFmMygiF5LY81oI5mOIOIna0pm3TLan2cqAavhI0Fp+ZduWvC0pFP7l430GaBFv5+Hf4k40+LGpcekZPp1HbJ4ivjf1TBUHNbvKR3GFSDhdzFoguLNoMmHt4DyBNg9TLABOiXmCaBO5AqUDkRemqQhhYk1XmeZ9C1tmf9bdUzHke2M9QJwCDf+fxR0AvZHUMYsvXZgdQoL+bKuR9OXv6csO2nle871h2P40YWgCyLyF8Wh6U3hcV15JdPJDeEcUINfYvdlSPrRC2LlwQPyCCy5ps3yE22kt3YVeCe8eL+tbX5WGGt3Bz/vAq3vu7vINz3ueDfQwQ1LrJ68HOWflS6dvtrCc00zk4fWby3ILLqyXHm9oj7/7yeH/NDrNxmp+skvlsSfyyyaSisbVqZjL5HpLSMTdl3IapIRZJ5K/y15rTVCXl5xPdD5e/cQ7hlaUT56po6VTq/cahaDfvfyQvrz4tbaDW8tOw7g5QB+B3RR0BK07GYJEgLnAvhN0PFd3v0omtclVmdFNX+tdbFGR2vSkWYdxSGtkBOg5TUvAvC1KJpfhi8d91I6zKnt1LSAqdpEVmvJxDfHdrxMumv0Iz8Z3lrzN+Irw2uNB+8/v/MujYeCKmLmbt+M9pHR8LxvHv0ozpomY2mymp7ey8o7Gdjvy0BjfwAJwTOGfDwE4M8GP/qklSz/mSeT9166vPy39jlHZbCNsuPnXaC7Sax2D8R1d5cfa50MHDfGIvjmgSOUCbboSUS9qg5j8Z3hs0UL0N+jPPJ4sPhkfwvDPcubJdhqfOkK4cXnuUU8eP/5nQf4+Y4Mq15AfMtC1jH5W37X/q1wXvxenlllu3C+eeXH2+14RwpvEXsQaLve96CYg0cHOo8DbQE8NLhrvq34rE6rVqe8Nut952+e7JATItqP1SZZAzwOup3uEuweu/Ti9Oiu+MtKz5o2oGmOfVrCR3Fq94juungekye1NM2VZ9zwWtM5Nq8g/l8NwPtBPbx1SGpN+6tpNrXxrWj8StL3xvAsLTCjMXnfrfFDrd39CkjYSU3wjqDdNqxJy0uDrPE+L1+zGrD8nc3XlrKxeOI8eDwIfNgpELcdGO67/M4pnMbSbH0s0zWK28K6eZtiXut0TSmTuR4rjlp+W+48XvUgUCWXR7N7jcFrsBnB4gnRWuP1BIQWfjVBUhOIWYHBwwTPAwmAoygn1Hw5aPb4CqwKwewETCTsPKGYSc8caed08/mEfALNAnQYrL6+gKHrKGDUVUuN9MAJWRhuVqQZWmNhqckL9Q3qm9d4NZ0piMxcy4/nr5WfufjPxBGZlNLdE4SMrxx+R/S8fPIqusVHhoYVruV3K19eWC/f+ESVU6Cz956JcprNYQB/D+DXQVrhlgqvEbW72hCAdIvaoH6XfnUaoyECTt/LQMt/zhzCngBwG5TDLmR8kv5SuZto1QJ0uMhtLzQUKx0t8c0Rdkp8U9PmYUq8suHp8NEBtV7c8qDUDZAW+DYU80aagBkt0DM/x0xyWNqWpfXVtNGMnymaEn/jZUPfNeQ1rwG8DugQAL4vtxZPlKceH63uWtuOylCb66z5vRN0oCqfL7kB4Nqg+nMMdMk75wMjaj8r7lID9HqGqJFZkXkMtEAzG/VaOi6tpUp3L3z0O4IWgi1hMtqiJ1z0b+vRNDM8ygqq+YrKoiYQGbx5/gKQ+bKEfQ6f5knzp79Z2kiGb493K/0ZiyXDay18rTPcAAm5Z4F21OyA8vBTAJ6OcsoNw0pbxFtGu7P41v6ifIXjxr+3h++XgDTei1EOUjgM4A9BdegogHsO4azF9FF9XABY6q07HjJEW4WcRGQuMu2s2ayFoeVu/c6q/5rG2HRbgtuKv0a/JjzHCOc5IfngXvrhoIrMFV02fK+BRiawFZ8MK90jYWnl91K5ewJYa3uZzpv5qPEkHxYE10A5YHQHpCG9EKQZ8ZpBrzyttuTluy4Xq4OV71LTk2n0ZIZVPttDep4Aun2P03MCdL3qg0DjnRsAHjiE04e3aphCOjMGKDMmW6itiISR7lE0atrhGB6iCin9e73lXMjQzPDYGqY1nyNYDetOsE1ObyBem0f6SkfL3LLcdVzSv579jejWJhgsPiKhEAlXCfa3CRo6+CbQWNjW4HYMdAbjQsVplQGMdGshDuGmNblIs2I/Vto1PzrtfIbhcwH8PsoZj6dA9738j+GdF41/GUj4yc7Ug/nNU7lblkfAeW8NXzspegxvnlqcoTEmLXM8Ubz6G5z/Y+LReTRHfshZ8U2Q5vIh2I3zqvLwlr1oXM4TstwB8JawXxzKhW9AuwHIdBzD1w7saz6tsUH921tmkx1LlX7/BXS15SGURfNfAroHRd4tvQTNft8CVMd4b3RaPugtNAvEEpShewDvPQsO48XN8S3V7zFxTAmTzZ8aIv5r9C2evP9jaM2RPglO6wLUSG6EchoKxyVPUwZKo5Jp4UX7TI8nVGQ8EG78e0f4kXHwO//fEP6XsLdZyY5A10lOn0wv88l3lJwBGsA/XEiuxM10Zf2w2ho39iWAbwWNB35woP8x0Pa5bxz40VaeFl6a7hmKP6ttan74m7yjRQ+vyfLRZwjKdH4MdIXp5SjDJOeBTuK+LsopQtyRnA26qe8ijDhYVvf8GXgZkYmLw0cCT1cqy4+uFLIyjuHJou/x5PG1DuHBdCW8OLyKOhdPNaHtCVPdWPgo+W3hpmlJmiwgmJ4WMDpcrf5E9SlKh3y3BJQWruwuZ8CPgmYtLwDtZX0Uijm7qejq8rTceazsu0HLYM4ECaGzQZq2zh9p2uo07oDK5u8AnI9iUup4LTDfx0An1vzHQMvqbBiyTGV5XgLqINn03QYJv68DCT92B8qumKeCJoCOoCwD0h2UdJPpbjJn5nhql63oTN8P/mo8WLyv68SZLN2549dlNKU8ZJmzRiTfN5W7rgdzIkPT8zOWHy/cPQC8AtQwL0M5ySY6vUaajGxG//FA7wzY12O24J2KtnXajDdmeAzAF0+IGyDeD6Ms8n6S4IfjYp54SdBLB79W/YlkysZYE3gsoopV0/S0n6zWZ333wug4Mn4kzYgHj14NGTN2mfDXElcmXyMassz4P1dMrsgt0HXA4ivSjGW6onoE5a9Gz6IP2PGxSSjNv9eDrqz8FdAe1y3EcUueJf07g7YWHldxZLRfprMD0qCk1qbTZLlpOny+4yH4Gqek52ndV4C05GegTPIwOC9Zft0WdEDCZSiz5NKSYJq7+PcORNVMToXOxEzBWELL+m4VkOfPE0RSiMhvrYJOfpd01qHJyPh02iK+PV68jkL+z0CfXyd7bIDMs2vCFtpyAJ6FBp+QooVWxL9M647hrv1IWPlnCc2Mu8w/fpdjVLy748dBR1udC7scvN+czzcAmdYXoggejsdrc1ab1GaqF7/VThYoC5jlxEgEK082Bxrngy6h14epWu3qBqCx1UsUHf4uNVYpdKvXYno9bWuDrlXeqcjwlNHQav40ooq1l8jwX6vElpZlCRWLLpuzOyimk/x+K9Ci3fsCeDRo14I0oTgueQDmKQBXB/CDIBPvEFYbtcXHlRXbcbfCZoS81clE0ILP878FStfFIDPuW1COu69BxnE2aILgQvWNeY00+5rGadUbL6+04NW81sqCv18NdN/wdVHyCLB5Xw7ffwd0//FbQGshP6Fo8/3JSwgNceq9wDVYFdIrHP27RdBameLxMifGCHNP28yGlfHq/JJ+IkRxW/nvCUqgjFXx4PO5AO4KMkvuDFqndjtQIx2DzzruYzqfSFNuMTs9IVrT3CywsHsjSABKs7kmmFhr2wSdsm3xZIWLaC7Uu6eRevzV2kRkGTHdMwHcDLu1WI/eDoD7DA9Awu+NoHuZ3wrglQA+rMJtAO0CUDeKbGI9f5EpPFZY6Z7HasRjUauUnhnpmeGtQnBqflkdUkt8unEAwBeBjmn/CpCgOx9kkkhIzVAvX4lwCqsVN9J0o85T1kPLJBwjCKPvWQEm6X1CuWfLcxuUp1ev+K3V2yhcZJZnNOha/PLbEdAs8EdBy1+0NaHB8XL92gCdNv7w4QFom+D7ALwdNMv9etCyoQWvp8k2asvuz1QIL+w6oRtDZBZkkdEwLDcvr/bSXF5HB7AA8ALQanwJOea3wOosr8WL12lcCqq8en+r9ueZdJ6prGlY31rqhxVf1BHK39wZRJcaLYx3OSsM5Mbbalqv5MejYf2WtCOLJCMveBLjo6CzDr1wOj2yfslF2QCND14HwJeiHKh6HwDv0tcIWoh6pIwJaGkcY3ujKA4dXvO9wCovLZqQhYhPTwsF/HxsTXctDyNtMaIZmRpak70WgJujaHhy8uLw8GQu5dYNh3v9D4K0AX1yueTJCm/FYfEQWQgtWrKkZdVFTc+qhzczwshwlsYqBdZlTjjNq4zT0oh1PGMVnYjvqG7Kso/gtWugzELzw0M0p0BLZ64Fslx2rZqPkOlNM2Hkt0iqZwWMDKd5GiPgsoKjptLrBqbpyTRahVhDzWyp+fFo1spZltE5oAW3XOGsNWjWmk+PN91APoKyNKTVxPIEkfU7EvrZPPS0fx2vfKTbg1UYy69057zkBv5J8d3jL6OMeEKqpgCNVSa8cB9KhPXSqvOOOwquo0uQRpi+r9NqtBEDDK8CeHFmtbMx2mimJ7Jo76WZOkb79TBWCFqwGu0OaBX+YcOvFVbyVBMW7P/T4ndLZ6v59co0a956/lr5srSUEyBz7MtAwl5u+bNo6M5+gXLHsI7HSqfmR5erpcFFQlgiMp+lAI6WtnA8n3PCR1gkHvZ3TaDsqcsQtt5bMUa4RAJzTNyR2dMKbR605JPld04B6JXr1PyUdK+Fcs0l78O08sMyo6Jv/K6XMtT40eGtCRdLAMh3i5aXJolIi5T+lwNPJ0H59iAAvyG+RYJPgyeV3gvKK947q+Fp25ZQ0cIwMml1HdZrQD0erDJnsAl8kaDr+c8oSV4eXg9YnQW2Cl/3EGOhadcqneYhSzeDOTW6qYI0qgitNDS8hlzL68g01eGv6Xz3KmqmEsvvn3bcM+EXWJ2MOWi4Gei8ux8A8Sw3+deEKb+zAPxH0PjWUaxOPnmdnax3ul16ay0jISp5yrQJr55IWfNR7C47LdSs39n6dR5Qjo/xGPZU3VZEmt+cGqWFSBOaUxiOga58Y/jJhskIPssUkt81zjTcIg3T0x4sfgA66sj6ZvXqFr+PAB2jdBxFQ5H/M9oW5wsv9LZOXOb/Mh/lb47zCGjM9AIA9wYtXeH1k2cYabXSK8Ha1ssMvjV/llutjLKdjvUt6tRlmjxB+3nQ8MAZ2F3GlmKm89yLk2mcDeTWAc5hKvHvKfTGItObesjwPJcg9Xq3vYBn9khYbjzDKyujbviahlVptR92u1Tx55nN2p2/PR5lLdhBhN7jypBC1BP2vObtvQBei7J8BGivk1pQa15qCotnHlvtX75HQpJXFWheLB5qgpx/y3q6CeQFoC4QXeG8cBkm59CC1gWdds+PF25snFPCWfxqwRB9h3KPeKpp9pYgrGmbMt+OGfxI/5YmscTq0hA+o46tnVr+RtqD9hflSy2PN7G6xUuHt2iy3yXK/Ri/AkonHwUVaUGetqzvZdE8Zdsl0+KtkUD9fD6ZVzLOaPhC71nOWiy7BLl1GEKtEbQ20FrmeeMRBwVjeNINNdKGx6Q7KicY32rapfc9ayKNGWbwTCWvEcrvWgh6PB5BqeNyiY5XNlPSo/nTvEThrLL0ZoOXKKb4f4D2wC6weg5eLR4pjOX+XSl0tNIj36Plc5cP9E4Mv+WMr6X5efzyYmbJr06HhlUvQkXEOg4rIqqhpbdVqTIFX6tYYzSqrClp9T6ZcDVk0+bxEoVfV0eR6aiknx31XdKoCRkvTm7ggG+hZDtpbV5qTZjdag3M05AteOmrKRdW/mm/7Mb35f48aK80z8RrzTjKc561vy7oDL9LYC9rYv+1jmk5hL0fgDcP7ycBvH/4r8NanY4Ed1iZdu+VVxR2B5hnDNASdK0N1KoAEmPMyUhFtvxlBXCrYI3MGe/dUudbO4iM4G0Rzpa/LfVN+vFuHKwJWfn/asZ3q1y1lqL5iYSX17hlA91w3HW9zQr6qHHWyuQkaPLp70DLZ6yj+z0NS/LIY4aPAp0m/RmUA1Xl2GSL4N8E8DyUIYfLQIe+vifg08svfWy+18lZlo/XpqXfLY5kCqxGx/+9As6opmMEXoSpGpPO5LGCZWyao4KUv6PKECFjkli0jpu+YhMlavg6/muo75EWEpWLp2VEvFnamY5Pv9cEvceHJaTYfSEevjHtQtC9GfrAUY+OFT+/sww4G6QB8rFRC6wKIQteuzgKEnjygFXdOXkaOP8/A6vLgqKOKspPGYfECSAvACWBqDLJHsarOJ4GpXvuMUJLV4ZMxrSgpoXJd917RT17VltjeOVmNcBMGWQ0NKs8r3DiyuS9dPeE23UTfEWoCUwvjK5/NQ1Sw2sbNQ1FhtUa5imQWflpAF8DujyIl+TUyriqCcFul7UOBVg9lOHjAF4E4B+G31cMfFtYYHdey/dzQJqunAiRbUn+tjRF67vEcSB/HFatt7MkuH6X8EwZ7acVUdw6o7KaUdSItF/rfay2qL/L/PXMLhl3iyaXgZW+y4f/3kkmXrxeg9UV+MaB/5Y0yA5ZCwar0bQIu0zcTFe719LFvPGY3wdBx8Tz5edbu0Ln6qz8Lk+jyR7EKvNtCRJyZwD4GwDfBjoA993Ynbc6bs2f/HYDlAujdJ33oLVnGYduR58B2kzgmkCKeiENS/sbI/AiRBmfNQ/HVPiWcFnhxzS9NHhaQI2XKJz2Z+ES0JhUTaPRnY/2q4USfzvPiTerkTFdOdPp8WlpflMRaZGetizdWfs5DFrs/J9AB32egbIUZAzfsjzkLK1Fb6kei2dJYxPAWcJd09fvHl+3EH61HwktjC2aFp1PScYzjUBXci25LaHW2kvL/+tGrSdp8b8OHvR3T71nfx6taB1WNk1WD3wItFD5cwYvkkeLX/nN6rGZxnVQJiCshql5tOKRsBqw1dg1z9GjadfCWn6lf75XYwHKY74z5GEAPgAaXzvp0LCEbE0DzGrvmqYlLBcoF7fruKJOR77z7xsLf1be8v8d2OVqxc/v2xhOGj+kPGlYGkpGFW1BRmUfg5qWGcXTos3uNbzK4EFrit73GrSg2ERZ87UAVXoWtvrOV49vq25J9/NA2sTlio5Vthn+rbhrdXyM5SPTrg+I0GGk4NtEWYbyaQB/BuCXAPwrysJpb0zNgtSOvDxrsVZ0WC3QrU7Km6H2eOPvN3V4lVp91NlKSCHJi7Q/B8TrrDRjVmWIKkhWYOg4OKyVyZ7abNGy/Hk0ND8twi5D0/JfCye/63yR/yH8RL+9ytbKu3w/DmqkXws6dVeCr79cYPdi2Jp1wFrf9YfnItinzVh8ZbREHc4rb2txcUv9ke86DrlbAiDBdwLAm0AXAr0Q5TqA6IpJXSZexz+X4hK1QS5zPhiXb/mzwkuBpHlboBwQq4fpvLYj84GHPBagfJVy7nOgMdSLAP9WuKwG1CIoag1U0stoKpmGpOPK+NWFkdWwsrB63mwPHTUoHS6ThzXeLWHN/7ln/68AfgrAHQDcCzROdQF2C0RuDLLRe2YR0z8LdOL0hbDXkXk8e4090kKtujnm0rAstkBa3kdB6+T+aXjegiI0eBmIXOTMiDRPfofxG85vSbcW1ooXKBo7j91a5qlXr/n/DmjogzVAbwcP+2X3bZQDT2Ud+yxov/Q/g+4CedPwewOBAKwhMlm9DGwx3VpNGuubpxJb5omFiL9WzakGS8XP8KH9tWqvHi9Wjyz/S74OgZZkfAzlVJIbAbjT8NwddLfDF2H1ztpI+C1QhMBtAPytwVsGtbPpvHqyAdqH/BTQOOcZwr+1XczqjHVHtSOey0GC78Ogg0y1lsTn+uklIB48wWL9ZjdZfmyqZhWQpfLL9zc/EKRdXR1F+4rMZQ2mc1PQ7YLspvnWQnCBMjb6EQDvBPAGUGfyVtDYqcSVh3hEAtCrbJY0tr7rd4/23MKEaUbfvIadFSJjTN4aLVmprG8Z91Zh6X1rocH7UuXm948Mz18NbtcE3Rb3nwA8GbTGq6YNMG43gjeNSCh4+XAKwP/D7pOJ58YCtGAYKKajPNMPmF4fraEP1p7+HaXOy5llqz7q9qG1O4CE19bw+xhoN0jUsUuhxsLuVig7VTaVfxmew10G4McAvBrUsXxW+V2gCPqVdEUC0Mt0T7OqwTPfPFMw00jHCs5IcEzVoFoRDQtkymBMfHPmGwtBWbHk6SJLkBB50/DcF8BXgXrr2hHqAN0vrMf/9H/Ji8ev/m41Sum2CTLjL0cxvz1LwqrPtToqG+OW8j+1fss4pGYq84CFy8tB2+oeCBrTPYKi1Y0Fy5WngTRovVe51s7vIr55fjgNh0FDCL8q3HWHLGemV+i0mMC64lmMRT1WptFmembLnxff3Jqlxcfc2uIccdbCZ+Oo5aEWMNLck+DDQLew2xyxylI22luDji//OFYPI/UEj8WfV091vBJ80x3Pbs/ZMXr56nUw2bC1srJM9C0A3wk6Vfo8lFNcjoMWC38SZamT1tZkHeFvfD3CGwD8FkrnpdMXdUh3EG7yv1eOn0ERetyZ1GbLl8C4McCakBpTUazCyQoOT4NqaehjkQk7RhBb4yZZc2gOHrJ5GJmWEnwt4RaAf1H+PY2JNctrg8YBP4bdjckyo7K8WmmUgn9uoRfxErlrHvQVoVG6vbYqNfdDoB0m3w2afd4Gncb8fgD/BuCloB0e8kSXLCzNWULX61Oge2ZuY/Bs/WZciKJh1spsJe9qAlAyOEWbqvXU2YTytzEVMxqHGIuMYMn24N4QgUVD+68h07lY2sFc4MYGkBl8AmXcK8pD1ibuDtpfGuWRRSuqu5bgZeFnncW3LkTpj0z0mhnpxaPD8+1+LwWd5PIE0B7cc0HDD18B4AdBGqEMy+f18aJtnoX9JGg87gqsmvaaf51G7txuBeCGTppkWcnO83XCXaatipoAbBV6ntm0qHxvjUO+ew03+jYHxqQjUvtb+cv0dJbgyza2KVq5RWcJqm/vB2kc56Mc625B8vqlw385+wrsrvA6L+VyiFZNqaWDGaNh18w7zZcXLmv2Rv55PPDpAB4JmsjYBs3mXhfALYM4NJ4GmoQ4BP+CJksh4vK+K8pssDyb0KqPmyAB/GbY6wm9sFe6164MHINsA5sDEY9zH/U11r+Xp1FjbGl4HqYK/xat3INugIdBkwpvHtys/blL8XBe3B00k2xtsQL8RlU7007GYQnP7Jl4rXmTsYJqyGiomTrA2twCpL09YXjnsc8tkDCSD7sdA/BU0HKebQCvAa0J1cdYRTwv1bd7Db/lKTM6LTLcB0GXqB+BjbCNeKusawFbICtzrSK10Bzrp9Vs9PxHAiLTkejK4GkCkVbbkpdZv1H+tNYJ3btz+FcbNJfOcxy0L/TeAw29LMKqX7XOT9LXM9jr6sC9hq/5iaDLvlZHvbAWtkGm8EsA/D7KgQu8BU/e9bED6sx+EbTu7/qD21NQtHqrrnrtn03oc0CrBPhuEy4bXUbML0BjypdjtR4wzZrVs1JRogowpfCj3ncKTQtWJZoqcMc0iLHaUo1Wi3Yow9T4yQjVjMlt+ZH0uNK+EiTYLGGmaXElfhh2V2j5u1Vr1oJT8zv3JMgYDbK1s87AylumwQLvh1HOG9STTqcG9/cB+BMAzwUJyF8BaYBnYHULoaUFat557/iXghbMW0ukrLoB0PmD2j0zPABg9yprD54AW4dZq+m3aCRWY9eNqyY811Hp5oSlMXl+9HuNpuUu883LW9m7W5oO9+I81vQe0Hlx3OjY38J4uBE+GKv36HK88l1qgNaR6lrjluav1qaY58x40hjzVf6X/ER0vbyN4okUAq0lsQD8OMgU3sDqIRcchoXk94N2/bwTZArzMhTNa2QRybz4KuXP0hq5XDZAmt8bBvfoWgDptlIXpoyTTTVnPSltNbiMdpGNL/o+l4k+locWGjWTIoqrRcjXem/tbjViSYcXxfK2OZ4p9Pjlge6bA3jI4GZd5iU1iROwNTivw7Tq2UnQGJdnWmm6USeiUdNQMtYA/67RyJSRFAo8+fBC0J0jR1HW1C1BY21/DVqu8s0gIfTdoAXP8m7iiHfJN0+WXBfAo1HM6yhtvKf870E343kL1T0+rqStz/yvaRNj0CpUag2o1ivuFcbEu25erV7XyrexgrhWVzye5MM99Uuxe3eApVFKbe4bBz/WGXYsmDZAyzduj3Iwp+Q30o51Ht0QtAhb7kSx4tVhPZoZ99q3CFOsMhmWNfUfAvAukBBcgoTVCdD+2p8Y+HwW6BAHeUK1vi0wygNe3P5QUF6ziW2FYSHHQvavh//W2si0wiQrWMsjiXrfs7TGxD8mXisjWunNxWst7pb8a83nDewu9znLoJYGgMzZD6LsuODN/zvq4W1M2yAt4/yBBl/ew7O1h0AC74WgNWjHQI11qWhti/cd530LNEZ58fD8E8jUW6A0ztZ2w2jJK1S+Z+Lw6Hr0GKxlPwBlvd/OkC+fHvL13aA8947Tr9VFLrdDoJ0oSxSTWz8883wSVK6fB3V0wO7Z+qa6GDWAsYKx1gCjMOtoiPv5rCM9tcbnfdMCcAztsX5l/Ly+6/dBlZ4XzVrCSZpmSwA/OYTlKxzlIaL3xW6NU2qemrYWivI3m+b8//FDHNI8W1edQMLNurmthQftH+qdty8CNMEhhdMSJIjuO3w/JMIBq/Qsvln4HR2+3wO7y1uXGe8k4gXZ/4gieEeXgzULjIqbBz1W4vnRkJnuofZ9P9BiAmb81PzJPJD+o3KzKr2mqStrixkV+fXKTDaw3wUJtsxYNPt5DEh75Mty5De+hlELUMkv1G+dN1I7loLyGgYdq9FbqI1Fali0ollRGSZbftK/jpOFCo/HPQWkBQOU758CHdP/GpAQkwueF4q3qN7xt+8a3vX4oddhAMAfwh8OsaDrOYB5D3yUGZoVWJKpaKB5v8b5ImTT6OVHbWDd8h/xYdHQg8Kal5Y8bilXjx7T4JX+7wKZtedidf2Y1dgXIA3gfNBg+e+CGp/cbsVb56yrFBlRPi3UOwuBDay2FavjiOjX8i0zeK+hBVgUPqpfFv+SrwXo8quHoVxU9AnQcWeHUbbCWXxEQnoxhL0h6JrPmjDjsJviv5wwGaOQrOwE8RpGK7wC0O9Wj7XE7grbGlcWc2iVWe1VaseewKrlWytf+j0zSJyl2fJN++OB9PNA43XXxmrlt+qhzrPvweql2/yfhSFrgFGj9wSIjFvmE5vZeuKwBZYwrmnpMqzHX2RZLZzfFqy8ZyFzGeiA0begCD9vK6NVx3V7ZwH2eNACaD0h5tHkDu6ZoGUzJ7A6LNFUr2smcOTOTNV6F53hWthJv1E4iy+vUtTg8Rz16tZ7S3y6cDMalWWi1fzKOGV8UL89rTSDiKZX5lzpT4IWu74MwJehvh9YvnPl/1IAjwJpkbztiuORHY4eV9J0dbzSrxagtTWz0ZCEDDem/kS0vLrR2p49Xvhu3vsB+CPQwuOno3Q2Vueu+bTctkGd4OOxW+v30iTTvDHw8w0oh2tEJrfJY7bieZCJz/iJhFxkvtV49GhGPEVhIpNpinasBUWGVq2Ht+jze1SRog4gg5rppfk7DGpINwEdr3Rn5Mf/rHieApoIkXycgH1ZOAszuU4Qwo3dpfaoOxB5vtxUbdpCTSOVfjyrAup3tk156eH8WQL4YpCweTTKrhzLevMgv/MC6+8DXYDOW99q+ajj2ASNBX4taHJE3nIZdRAr3yw1fC8eawZxP2eA1xV3NEtXm3nXM32tcVrhrSUwU9NvLa+RS1R4NvHmAN4OqsQnsGqq1h45IcH34n7bQJdnIY+C7h+5G+gAhbuATjveAfCKwe0CAH8haL4LtAH/TgD+dHB7L4D7DP7vBtI4r1PJv+jBhLydq57WeJaQ7keG/1+PchDCPw1u2VlYSZf9fzHoIFNe3iJn46M6IGeETw5hj4OEIEBHefHeZbmHWaZf8jxqSj7bEKxGMaWxj5nyb13W0Rpmjso5Jn+z6fae1nQCu/mI8poF4NlD2AtAVxGy8POWu+gKrys/Xxy+BdpSd3Wsrs3TeOEQ/s+H3/8Z1GBYiP6C8Pvcwe1tBh3dkPfq0WVklSV3NLUyH1P+fCHUz6CUxd8MbkcculHdZS3td7DaEcpH1glryZJ8eG3gFoDHDbTPwqrwc/lh9TbCovJdwlOHPfXYMi2tsRrtx+PJc6+Fs3iI+KiFn8tfS3gtqKwwMl0L4Z6JZ6HcvTgYcr/mHUF3T9wcVFG9o4ssfqy6tAGq+OeD9qPyzoUlyj2wRwd/LIA/D2oYv4ui1XwedJfEYawK60MogpUX6rbWuSngWWeOV6dfdxosHCyTVJc7sLsORGk4Dtqm9i0owwuvEuFq9U7GyabvHUDmNO/68Ex1z8SX7yz8FyCh+v2gRfCHYcudlXrfOv4yBtH42RxjJzV6UcFbkBlkCeVafBmMbTTZMZbIzUqfdPcqG//2BCf/luNtp0CHab4I1Ii2sLqcZMUUwWp+14T8IVDP/8QhDt4fKq+T3BHxfRzAD4AO+7xscP810K1ofA3ltQRf3DakVqIbo5UPY6AbPGs2vNbxzOE5giIY9XYxFpQsECF+62EE/i21LagwGOK5JYDfA+2E4cXorAFaBxB49UPm6U8P6bHaY5S/so5Ka1CW1bNBd5xcYdDaxdc6Ln7WPZbnxu7rhNZarO9eBc7wFmmcc6TNq0za3UqH1/HUhDnznmnY0p9ML1sWtwaZnrcACSvvoEwZb8Sv1ja2QEso/g9ocJ61CckX1/H7A7gZqJGcBbo+8Vkoy3JuDjpzECgm8iGURm/luUbWarC0ae40doY0PQk0hnkdlD3N0vRjgeZ10l6nojVCab5KvxugjuFmoMNojw18PBN0Bp9egynjs8r3CEgofQfo1Gl94rPOD50mr03J+rAElduvgcYX/xSrR3pJfysOrWMSuiIepKclXWPG7OZMszUGavkZM/DewkM0zpTJL4j/QKnY/xNU2S7D6lY3qzFqk8569DjREkVA/Y8hzjNBlZ7Hrn5DxcNjf98k/ANkGrOfVwxuPMY1Z/2xyhPi93UAvNHJo/14ZLn8LNrHG3mr4ibogIpLsSrErfKWWyKtsUH9LIV/3irHWqq8olXnOTCiAA/KE/Hekq69zoOW+MZM4NQa3ZQ4MmkDiklyK5Dw41k+ywzTDSASgNofm3F8UMKtQVrbYZR9przLgAfLl6BZYKAIyQcPNC4bvj9lcD+C3EynblSt+cbaFgD8PEqnwWmUx9Jvif/cqcj3qIPZFuFPiucUbAGzDboS8+Wgy5GAVVO2Vs9YAPKY79+KsvDK3+v4MvVBrhD470Oc3tKYBYAFv0Squ/6+bmhVt9WcbPW/X8jmq+WP0yfXq03hw4rDKocslijjcX8CWqLA439W+ej658VlhVsI2i8BmVe8KJaPWX8baAxrCTrp+MtAY4KLwe/rQMKTBcFdQDPMVfMpkQaPZ/7GgmIbZGq+DbQ9DKAjw54LMud2jDCy47HiYz4sM1j+lnSkMF8OcV8IymM+7dlrY3rx+AIk2E+A9vv+OspYLfMW1QXPTYddYtWEvxS0rOkDKMMKLmrahKc9eGFr2kHWb0uYDYzjaZ3PunjZUP89P96yh4z/Wp2I0so0WKN5AFZnKaMePFoCYZnIskGzVsHrwXgW+BxQQ+Awjxq+84zvrw7hjoHMp2OgJTvA6kTDHGUvwXnFM80L0N0nnxJpugCnH2R6uQ7cCcX0zZRpxgKwjjPjOvAbQ7x8YpBbd71JEEsbmApdATJ+s2G83nY/wZksectqOhG454vCWj1rlDc6/yz6UXxWefEM7GtARxfdB+WwAk2P49Pxa+1E/tb8cC//SNDav8XgdjfQ1jsA+E3QpMw1QA3yYaDTjHlpzjZoTPABoAXbrJm1wNNqJN8yPYwNkPD7GGg2ehvUkH8RtFxnQ9GRcWihoWnLOKT5qrVB+V/HofOd9+5yHp0H2if8NhEHQFrt74KWFW2rb5J/jkP+1+nQdX+p3BYokyALlE43xDq0lNaecc4nO56leYHxvh95lE2TxVfEa0ZLnjIWKAe9udflsR8+yfkkVses5FMb6K6N/fDg93OGOHly4+mD+8dBS2CYxxuCrnPcQTHrPjH8//0hbDh+NPPDcX3bwAOn53R5XgkaZpAH1AJ02TqXfW08V2qDWjP0Jkl4TPOKwf8Lh3gPI7ZowP/3u3FPeU53/r2nNvuaHZRf9wxyJs4jIHP01SgN2xN+NQHoNYptlAbwdBB4guMlg/tLht+8SPqVgzufGv120J22SwDvQDGfxtZJNPhnsHb0c1idJT3oz4tQBN5h8f7TKGUuJ2gi4WcJQk/4sQA8MTyXArjdkK+pslvHOsC5waqtBc/9dIdW2+XvhfHdC8//9yKfrHLiyrsF4EdBl9gsHL8RTQ4jf/N3qPfLh/+nQON85w+/3zOE2wLwY6AtcVegHMP1RNB4IUCLtq8N0hr1ILqVpzI91n+rvHTa2G0DtAbwxaA1c+cO33Yt3xBgQSE7Ixm35nlD/ZZCweJVukszehO0L/inBh742wnQrXI/DhJ+PBYoeZG0Jay8jPxjiPsM0LbGd6IcvBHRXiGY1UTmery4a2Zajd9sL5ylo3mthWuhO+bJTkR44TxNEOp97nJnIcOn+PIR+DXz1zq+Xv/mh29w+2EUXAfAhwb3/zW43RHAZ0ENky/U/pPhGx/N9CnQuKGcoND5qde6RWvhrPLzNGY5gXS6gNPBfH8DyvH1vE830vYt09fSBnXZywMRPgOaRGJemC+rLV/5raYB1jSNsdDM6Pi87547f9PhIzpZLUQLwZpGKvmYC1baop5U+7H8aq3S+xbxZNHWkHz/DIBHoCxTkQPienCc89nS8uR3jwcdloXwb4IG5q8AmcIfAvCDWNVsmCZPPEQaeQustFi0drBb+DK0ALUg84W1V2spiK7LlqCW37ZRtuNdomjzjppvAI37AfZlSVYb8up2rb1z3EcB/BJoTPcQyvFaMj5YbtZm64MIL0NqjSBCS2Zb4TxkGmMNXgXJ8mpVbP3dQgufGX/sZxtU194O4P8CeDKo59b7WaNyBsq6R1l2Vs8OUMNjLQ+ghcWPBc0KH0cZrH88qOEsQBoEULSKTVCj/kaQiXwpipbDApWFhS4ja02cfq+NU0kBIhuv1iytDo7d5Tia9iPzT+atXDrCfrZAE0uXgxYZvxJlredhUJ4+BsD/Q1nvKdfmMbyOjf1nBKQMcxh0N/D/hj1r7w0/XPl/rLmDkeGmxOO9e+G0HzjuUbpa0jnFdFxXfnrrAdcxMeLlLYa4DoHGtD6E1bWBlonDzymUQe4lVs0euTOCTeAfG+LjbWxvGtz/DXSd446g9cuDX95r+4rB/XUDrzyT/CSsCpOr6vNB0J7qBcpkB082PRqrx5zVylVOYvD6PT7bj81mb8af//Ouj8cOPFj3toR11ZLQWWiBMtZPCw3vXbpZglJ/j/iywmRhaSRZWgvUy8ISMhFdL49kpc7ElQXzZGkkAFXQz4A0wAV2r1ljnljI8YEER4bnwyBBpycmeBwOKFvg+M6Kdw6/vwQkfJcDrYtAl3ufNdC8H8phCG/A6snSvGh6jvp8uuLFAO4J6iR4eRNrft8MOp6ej6Cy1vrJvNPa3waoU9wAlR9fss5nBVr1dWvw94oh7qPYbSFEWADts8BMeE4zSfqdWsFkQ9rPyuoJs6yAs1R+y18Up+VnafiNTBUvbouOxZ8uB95O9TwADwUdSMCmJmsFC6yeF3gRaAnL3wF4LciEfQlWhb+s9NdSvLwQ1EDlItzLQGNVnwY1nHNAd99yPrxM8LsALfN4L8rMotRELI1b8iWxxO4b6/R3mXf8m+OSgl6C410x7dQ3HY8UKHqWW2pph0D5xXnCHcsCNI76ZNAEE9OTC7aB1TxYqG+nQGX9v0B7oC8A8OUAvhLAXVE0ulNYnWVeDvnwMdAWu5NYXbMZtbNdbWtuk2sdNA/is851dV4eWrO5Hh/e7ONU3seG1QulrwsSKvKya34uBK3m/2rQhIXGdw3+2OSS5tBzBz+8ju8o6Mw/9r8EnRcHFBOXF+teDrrx7BxVBh2lDFnQHAXt7WWh3jKDu0QprxcbcW2CtM2fBg1HSC2Qx3W3QZ0osHpqT9NKCWsSRP9uxZQKMzXuLHRPC7Tz7Wk+c/Dv8aI13IhnbWZI3vRvGW+N/9b0yXxeoMwYXgy6FOeloAp/IciceRGo0n9O0OBB9SVIA/kN0Pl9P4rdh6yyNsNm8i1Auz54u9vvg2aCzwRpMN8A0hD5Up1rgiZDPotyHuDtUWaOeeBfpktqZ9wIrbzWQgKw81x2cJZWKIcOFiqc1ei1ZqjrzYb4f+Mhna9CmUBivvmGuBuCTl9+EIoGL1GzwHji5C2gtY5svjJ/WyBt/7UAnga6s+URoFN7bgUatvhlUN2RdxPLNFoweVqXFqN7fu/3QX0sHiMNbOwavWzc0XdvgsNbjzbm0WmI0mRNumi+udE8GmT28DgbQ558LMPxmCBQDjLg8cIlyla4qw//fwRFS3krgKuhHIl/a5SLeT4G4P2DX55I4fHEh6IInytAmuRJ9VjrGfVveRTVCfFfP5KenuzhMMcNGt6xVrXdNVLDeg3otBw+w4/Lime/7w+adV2Cxk63YK/p8x7edvhe0NY5Hvez1lbKXSUAafX3BvDfQOUrO51svdVtYXQDyDaqqebXmDjmEEJz8T/liYRYzfTdi1nfWj5FeQfs1hxY6EUdpmwcGwD+AKUxLlEuOWLT+cWDO99tC5Tj5V+N0jAfCVrCsQTwZ4I/5vHhIC211sBP1+ci0HIfBnc8ctnPj6Hs6T2G1dvcvMXNUvPlmd1LQTftAbbw03WGz3iUmGWIp2USZKF+Z0wlazao1YTKmmQL9RvCvaaSRzQ1vVb+x4DjtdKSCVdzWwcy+STd2ETlOijv8sjS3QTw7aCJj4didTCfzaLrDb9fAVq7dhSkxT0HwH2Hb78AOiT1gcPv66EIviWo8f0laHb4SQC+buCbB+a5QUlTk7UqWWaWQNdpW6AIEWC1Xi+FH13fZVw6Hh1eDhNcAepEng3aAXNIfGOt8xYgk/PBKBopa8deGmQ5LVDOAdwCXbD0hoHGKRUOsPNSp8k7pSeq77viWOdeYEvwyHePydYGawm+MY0+Ei5WgVq/pwgbXVEtLNV7lMdehULg1gorzyKaVhpbj5tiGjxDuQRNlvwq6FpEXr7CY1NsLr8L1HhOAPgq0F7VHdDi7CcPfo8Nfs9DGSPk8byjIHP5iQCegSKoZB7LZRheffK0E2B1Z4WuTzLPNgw3mTfyPz96yxkLlBOg8U6gHAm2AepArgYyN394yJMT2K2JaQVEdgachhOgsrocwH8BdTZnolxQr2l5kMKQ4/IUBa9jkP9HX4okI4gaUovWxZhDW9GCIhsmKxQsrcRLa1b7HCP0M368+OfUCudI4xgaWyia5LeBGvC1hT9pOvHyjS8CnbHHY3Lfi2LWcYNcYLVtsFBlk/gzlbScTtjA6tZEPrLsASDN+A6DP16yAqyWlZUPsmPgjugk6LDal4E6k+PC/9i6o4Wv5C1j+S0ya2csIkv13yRu+NnLSqMzIuN/zLfI3zrSq7VNS/u0TDKLRiYeL16g3hCytDX9Fu2UNZYFSANks5a1BdaqHgla+PwYlC1vzwMd1roJWvryEKzuNDg00LgRaNaaNaAjWL0RTfJ9w4HO+ShCl/3KSR3+L7VG1ux0g9blKE19PdnCvDOfxwG8GzS58X4VnuNcoOyuuSnoMqvHopjBchLE4svrYHmx8jHQsMHLBp5OiDBTLT4rfK2+L/XHMU80yD7H7ONcA/YRD5H7mPizYWoztTV36z3Dv+fPmnSYOpmy7jyUD4x3HsP7epTG+lbQdq5t0CnLXzL4uRZIQLC/Fww0rjHw87PD9/ujYIHdF6YvQA3+RiBB+wdDfMt9eD4EOn3na0FCWc+W6omFmw/p/DiKEK2dSRhtceNZ+YtB2iSG+OZo01Yda50svXJ8dA4mWiv8HPG2NhYrTiv8VN7QSGOMoGgtbC9MS+WZuzzmDCtpyIbOFs7jUbQwPjiV7424DlaF39+BBOImytIcPsZrZ/D7GKzOYEvNTk/8bYC0wYcDeOpA640gQcMz12OfkyAB81bQzPVPgdY13g67sUA5YUbyeBfQguZLBF2era3FLzVOKQB52c47ANx2iOco5q1rUftJt2v5Ya+wwHymoaQ1J91snHp4YC95kPHvdbrHQOdVRD8Tl/ajw++gCMMtkGD4HZQ1gH8P4AcA/BZo3RuG9+8FmY1HQabafUELbllwsNb0epAQfTFoTJDB3zmt1uz2JoAbgHbD3Axkdl4fNH55bdBCXxaqvPbv88Nz8fB8ArR05WPDu55QgOCZhZrMn4eCFiE/DGVGV97YxtDDHPLdAuf3IdBOjp8Ard9js9cbVrFoZupMxEsKYySslrJzS/V1aA37xeOU9IzR9NbFV2Ru18Ksu2xlGJ6ouCUIvB0OoLG5S1E0mMvE+1NRwP7vCeCTKBvz5UJkDvdB0Pa7+4FmTSV47Ew/C8wPNmn54Ahrz/BtQDPer0PhfxtlS6Gn4WXd+RsL29ehLKi26gMwvn7MVWdGR3A6CJQvpCc7rjf1QSLudZX91A6NNbRDAP4ZpIEAJBD4yKu7Y3VB8ymQJgSQpsIznQ8AHZbAx3HpE43ZXTb8iwD8Nugy9ptjNzZQ7kg5Y/jPzxHBOwtxKdAPq7BnDv+ZjrWi41oA7gcS7q9COQF7CdJy+X4WvXukZvLqMUBvbHALRbuW43/A9LoytW7PNga43wnZz6fWYOcUFFM1qrnTdpDi5rxh8+0ClDPmfgqEIyhjejcGCchLQcKKv7MQeQTI3NxGudDHOrafNSge85JC4HMgM/sZoO1+56O+7EynRU861XB9kMB5AoDng+5DljyxJstLXXawmqZoN4c17mdNhMiOZYmyM4fHADkdc9aTMXMPGwCNAfLTYkfLwsiEq9ny2o8cq2iFTktr2qbEvW7sB2+6TMbS2ItxSj684PtAJ0+fBAm2Z4MWMC9AGtPloL2k5wF4H8pylW0A3woaC+RdC97xUxrSpFxg97KRE6CLmS4U//8dNBnyGZDA3EKMjYHvc0FjiDcCjSHeErSv+XYo6yAZLNSkoPDSwW1woX7r9oTAjf3zGOy/gra9yd0t0q9+z0LyNbqOysSuG2MS2TEeLUIn8pv5FpXtHAI0Cx7wfzloyQoLlEOg3QePBe16OBPlCK4jIEEJ0Ll0T0aZtGB6Vtq8fJH+5Y4OS5DugITxpaBtaMdQTNNTKJrgYZDgPhtk1l4b5bAHK37Jv6dUaOHmCRSddkv58Wiy4L0v6GQXXlcpw7XWj1bBV5U72oxoNUnQ4LcWXtMaqw7vhfk2hteDOm46Nc+8vMiuG7TCt/LE5u/tUW6dY3OOzbG3oizLOBNlsuNslEMVWPh4JmG02d8bJ5OTAydRhByPLXpjbrWJBp6U4UXMkfkq07MNO31jHis8C2HuZNgM5gMsam0Bhpu1FnVyW5frgTijGJIZT8Ja0rW1p1847zW/Fi/8v9YjzIEar5a/ueKeW5uSeZZNl4QXRjbA1vBRGE8ALkFn1J2BVXOSl5PcAXQgwj1RjrW6NmiZy2NQ9qxuYHW3hKxbFp8L413/5sbLx3nxhMcC5W4M+UjhxgJOCnVJzzpFR/K6FP6tNm0JWRj+rN9W+2U/rPU+CqSx8gnbmj8Nrz7ossjUrRCyAnkJ2wvTpYZahs0dbir229z3yo7zQ+bLmHLOhLEEgSUgxsBqdGxevRJ0ZhzvE5bgrVmXgHaIvBdkGt8RJGD4TouoQ5ACLSpnL+89v5nOfUynG9GU5RKZ+h7v7KaHCmT+LYfvDwHwt6A83lb+9q2tyAoSSXIPmQo8hwAaS2Pdwm+h/jN0w5sL2fRYPaPuPa3Kqs2QLH3r3dIc5uyQJM+82f62oAF3bnTSLw/KnwBNIvwlaEeGFn5MUzd8bZ5lhLllRVn5m9GApaDKdDyZfJYao4VsfJb1xXRZ63ugCKP9RVplBqPlgzctz4WrC1j3RJ66L5ExazMJmKI5TDHvtBkj6WmBEplKLfF4mNJTWnlgmUpj6HrDGJ751NLrW/XDMu+WoEbGN4ptKr8c32GQwOM1dPJMQs2/jl8K0ozwi7Qmz78lXL2OVndkNT/ytwy3LdzYvLbyWL9nOkr2cx8Uc1/Tt3i2+JwTS6AsgzmoOEhm+H5jv83q/YJntmsNcAt0ssu9QNqg1OgYXieg3azhARZ8DNZsWIuqmXOWUJtSr72OISOcOD1LrApzvl3NEqytVg3nB0+MHAVp229DuQVw37EuU20qvN51Hb1AC01dgecUSOvS/mom11i6Y8wWbUbW/HI8lgZuaTW/B5p5PAKa5JBHTQH+diwvbgYLv88A+HOUyRIWiHx4QCY90fdsHgKxVuz95tljTg8Lu78FXQ8glwR5WpgUbJHWKbfEHQUNOXwc9nKguYdFmrCY+WnZMjXLVLZ61pUmbw/sXi1tieKx8nHMbop15FPE65jlDFY58Ho5ALgHSMtYYnXHQ+ZZGu+8VORylGOd7gjgx0HHui/Vw3uF5ayttYPE20GR5XGpwlkXMvFM8ins5vN1oFv17jbk39VQ7kjhZUCSf710JroHZEfk/SnQbhxWtnR57/Xupl0d4FgB5AmE1kRZfrGHmbIXmT6nvznij8rK+w3lNqaMvbWaYztCTYP38Z4LuvpSCiVr/ZrXkKWAYeHxuIE27ynGEOe9ATwLwJtA2+e0liQFoiXEMkLPE4Qs+KTA4xvi9PrCbdDx/88F3e3BZcppWoDu/vgAVoWgl19yb7Re/8dxfwS0rRAoGnOtjXt1Y13tczbitYaUrcSZTFnXo3smr6eyGvKc/NXywRMomd51qqY4NV8jvqeW+QbKYluAbjl7B4qQYcFgaUvyRGUpvJYoJ8WchdW1fNKcOwwSIN8MutT99ShH52thpYWkFXdWAErBI+keA/BOAH8MOvbrrigdBFDuS+HTWs4Y3O8J2pa3I2hqAajzTApgjv/PQMd8Aas3vy0Gt2xdaa1jLXJnI2JkrsaRNYum8jHGT0141cxOnT5PwxmTZy152sL/HIKmlp/Ru5Xvc3RwsgHIy5DOBvCTKCeh8AJo6xQUKVj4pJfnDHTOQFlsLONhYSiFCwaebgq6gOnpIA3REoCW2W3xY42/yd9bIO3tWaA1jrdB2enCOALaAcOdhEzH5vANoNn0SxEPIUgtUJ6K81bQ9QMMLfymPgi+jbFMUkTGmihWZbfiGaMtzv1kNT7LfxQmIxBa8zCjQe1HfmYE8ZyNwatL/C6PrL8jgL9Baai8Xc4SLKz5vWQIKwWGPKpKpgMo2qE+Kh8A7gx/TDA7JukJQda8vhe7IS+Y9+o7p2sDRRN8rKDtaa3S1P4k6C4RPhPRilPm1ZT6N6XO6zqZbniRCRMx6DXeKCHrFHQWf55AyaTTa4jraOxzaZ2tgnNsmqw4ovyeM4/kb3kyy1eBTiiR44PyCHgWJm8GjSXyQaMtvLKfQyhn/Z2Dcj8Ix+mdxRdpf5FGeK8hzjMRC6ConOQBsj+Jog1L3riDWILGPZ+LYu4CpQMY25Zbtbix9WQDEyOZWmmnhNe8T9GqovRFmuB+CeqWfBwj4KI8GMv7OvMpw4u8BOgskLb0dqyOz3HDfifo+kyAhNeYPJSaIh8G+uKBPh9EyoI3O85nCT4ep/sPlEucPC1VPgydBg7LJv0zBc9yjO8zoImmCwStuczdiOe568aoRpFlfO6KP4fKu44HI+LwNGL53qppjc2XTFkftLwfqyXwoD9AgvCbQAuouWG/G3TOHhDfYoYgL/XDwuSHUcxvPaGgx9es31oASqH9AsEzCzKvXC3edRrkVZjPEXF+CLSs5VYokKe8HPRnJe16K9xSeFoq9wyy/jQWybAZP0xLp8MLK/1Zac9gTDjN10J883haqP+algy/NN4jPvTvKNxC/V4qt6XyO7ZezAFd6XeG/3zp0fNBM6X3B12c9Mug5Ru8pU6nTdOV0HnH/9n9ncN/6zpNTVvSWhh+dLh/VW47ipbkw6Kl08A0DgF40vD/vaD8+sTw/ShWtVBJ26sDVp32+PDSHNWnzPeVH1Fm1JBpXF5FycQ7tvFY4aI497uRjsXYSmL592hGwqz2uwVzlkEmX/g7a4OnhD8+WUY3XBmuBRsDvZuAzO5rCh6znZMU5DJ9OwP9R4ImbQ6hCD+PVgQtnPi3PGRVdg4Wn+tsS1ad0zyksTGRmVqkkcCZg35ruKXzbR0FNqVjmRrHlPREGoOnLbbGG5XBOhuP1pqXKBMRfOHQJlaPa5L/x5Qp5+cRAB8GTa4ARWuKGnAtPhZ+nwLwFqyWHcMro4zglbT48Ahg984Sye9eCj/NYzPGCMA5G3a2ECJEpoT2Z40HZDAmg8cKWp2evRCkemzJ+j4nWs2eueh735Yo28ayZn8WnKd8YOurhXtGYFhDOfzOmt5bQMtQzjDoao1R07X4teLmHSZT6snUepQxbZvKqUUAZgRSayXRppan8mfRooGMNRGnxJ+hU9O6xqBVIOw1pmhYY+Ni6A7R0hLn4IuF1T8P/zcEff4m47M6a/ld1uHXoBxiwLAEp3RvQatg835n484qNRleQrAAzGgaLY0361/Tb2n0UwRE1ItNgVfpxmAsf17PnOnxp+bJ2LD7KYSjOst10sqX1rTy8VlvAU2yLLB7ksUSdhZvLDT5eb2IQ2vzre1KwqJhoaZdjhF8kocMrI6tGgcLwGzFz/qZ2pBahe0649FxZRrCKHV8JmizSgvjuTR4L92eQPXibeks1pWfY+qsNUFSi2MDtH7uwuGdBZg+dWVLvevv/BwBXd7+tiEOOfOr06bdPR499zHCsxVTFQdv8s6KA0D9ouYogjF+5jInrDjnNml1z+yF9XqtMaq77qn1WE42jihcDVN6a+2eMWVaOou5NXaLvsXHXLyz2fsSlGOo9H7dLFh4/iNoWQoLVC/umnblaYpWnczQb21jMtzYYaDm+rFAKRQd+ZzQjXuqEFyXIB0DOSZj9UC1DkHDG7SuxS3D6+8ZeOkYA68OWULccj/omJpXm6CLza8FupXu3OH9HNBEBu/G4Dj4wIHLQBc6XQI6seVzIHP6UtSFha4jXn0F7HKKBF/Uebe0iaz8kbTHyKsrw0mpv1fCTzNyOmIdArjWS0djeHPwcpA6FY111c0I68yPudMilRgvvprmNkaoz9HxSniWiye8J+cja4A6knUhUpWnCEedIVbmHOQGnsVcGpPVM4/V0CPNocMHbx1jjMnzqePtGcG4n4iEnGf5NOWFNoE7Dj4OSuU8SMgMfu81rHI6SCb/XtajUcJJhY+Gi0bDMoEzRFtt9Y6OVkypO1Mb3OmKqUJt7rH6OVAry5qpXCU+dUCyRv+qVgk79gcts4cHrV56isdeCiBr8iIjBPdqCGQtndpYE/gg9A61af2OqyZqY8GR+9w4ncZH1y18D1qnAyDWAKWfLOMtpjGwu8eWOHCZ1dGM2hIgb+lEjWZNY2o1lzRtC9ZEW4SDuuKhljct2l+Un9HkZoaHKC4vzmZkBaCMbJLN3dHR0TEDZlkLmN0JsnTeLaJW2IM4S9dxcNA7z9MPtTJbx5idpZlOot96HNYCu7VG/h2tSVqq/x0dEntZLw6KKXq6o2amTlmfGNHUcUeTuBGW7ElvhYsiGLu2qQu+jv3CmHHGjhj7tQxOa4DeQuiM9rngP54WGI35ZXvRKbPFvZJedbCuIZJM3ev17ODDK8cWeWTKokgApgiMQK9wHXuFLgC/cBHNMsP4ZtYFOaYXLS2ofYsi6aZHx16h17GrDsZMsuwSjgv1YcrCzYOwOLqjo6MjwoqsW+c2OCvSjo6OjgOD2gRIR0dHxxcsMhMg1m6RzA6Sjo6OjgONqUKsde9vR0dHx4GBpwG2rPPr6OjoOC3RxwA7OjqusojGAFvM1m7idnR0nHZoPQxBQk6EdI2xo6PjtMMUAZjdh9e1w46OjgOJvRBOXQB2dHQcSEzRADs6OjpOa3QB2NHRcZVFF4AdHR1XWXQB2NHRcZVFF4AdHR1XWXQB2NHRcZVF5kallkvRJfoBqR0dHQcalgY4xwU1fWdIR0fHgcdchyF0Ta+jo+O0w9yCy7qDtaOjo+NAojYJMuZipG7+dnR0nBbYQHy8/Rhhtq5Lrjs6OjpmxQbatDZ5jab3Lv93dHR0HFisW1B1QdjR0XFg0RdCd3R0XGUxVQBaZnBHR0fHaYFIaGWvvBxLv6Ojo2NfEWmAfQa3o6PjCxp9DLCjo+Mqi3UIwG72dnR0nBao3QvcKszkuGEXhB0dHQca3mkwc9z328cQOzo6DjTm1NL6QQgdHR2nFfpOkI6Ojqss+ixwR0fHVRZdAHZ0dFxl0QVgR0fHVRZdAHZ0dHwhI5yHWLcA7EthOjo69hvumuZ1zdLygug+C9zR0bGfCGXQIcPTXFpbF34dHR0HGmwCTxF6kaDrlyR1dHQcWPClSMB0ISgPR10a7h0dHR0HCnslnLoQ7JgLcxzU23FwMVf5pujoWeCaoIo0uoXzvVfYjjnR69IXNuYs36ridUj9nvMeYGla91nhjnWid7IdrVhc+cf5aFWofk9Ix0HDHGPYHV94GGUCM7yAmUpWE3C9onbMiV6fOkZjzE6Q2sxupkIu0ZfIdMyDvbQouvWy91hrnrcKQFYr5xRcXRB2TMUclslc8VxVEQ2nTYHO8yy9VFkdxB7tIPLU0dGx/5h9bmKqsNmr2TdroFvPMnd0dBxsWNdlzHmFRrM86oJjfVhn3npmQYspqDuTvTbvojijnj6DrNk01ryKaES0suWTKZtMmXm0vPoypR7U7gSaStf7ZtFNC9Wa3X5QxjxO53Ve0RrI0zVNewWrAUtMWbeaER46rtZ2sY5DRsYi2wnMGdecB6uspcM+nQQgsL/8nM5C2MPplqapAsVanJ+JS6N10mVdedxafnNpZa3xjbVMMmEmpaF1HWAL5jQBD8JVm1+Ix4SdTsJvTmS2fAL+cq2DUoat5WelY66xN49uC48tmnUL367fvSjIsT3hQTIfLOx1bzoXDoI2XUNte6X1rUbL0vqiOiaHLiIBaA1vjDGX14XauN9+oJbvNXdrvHHUOOle3AkyZtHzQRd+GqcDjxKnC7+az2XwrYaM1mdpMjU61trYg7BCQQuJqettZ9O6HJoL5OVRi1Ye8rFXlyLpzKtl5kFsoJ72sd+8tjaw03nZUJbvWgdqmWiyUWVNZBneE5b7XT8kppR7qwDV9Wyh/rMf6RZp+zV369tBGDpbgcyEaNzAEpZjxivWmfCxPM0Rb/Rbf6v53690jMFcGkim/mnNROdTS4e+TlhCxvOX0WgztFoQ5at+NuCXjUVzcr6vq9Ci8YbWcZyxY20HacxjTkitQr8D00zDdc5W6ji8Xn8dE3CZcb+a9hCtb2vNezkut98rGxiRCb/OOjbGEmTBN9kKW5cJLDPM6zVblxJEbhEf6+jJPD7W0aHoOL1xsIy6732bc4bbisOib42bzcXHmPHmWl62alAZtCzDadV2WiwFC5kyq8Xn5VekvWXLbpYhqL3QALNxRLNwnp8sL2PXe2lEs07r6s0zPaTOoxateW4NsMYLnO/r0gStTsPjUWsVkaZmaUaSpsVLq2D2Zjw131bcXnwWPSvvW+pF1LHW2pelydXiHmsV7gq7HybwfiCqfPtthkzBGN73wuS14pxqRrXGI90k5uhUvTizpl7W+smaedl6MGZooAW1diZpe/VgHR2y29HObQJbPWtNFd4LZHqwSDXfKz6z8IYV9G9PQ2id0WvhKWM2ttBswZSGq/NTu2XM31q+tlobNe1nSmfihZHttgWZeuilx6rLcwo/prdL4E+tnBn1VGNd4z4tsNT8GvZ60NrjMTLhpNteIdLuLHOtZlqui0dGptxrZmQmjtbvNZoanlbTQjNqi7W0t7adiO4664Guaym+91I7i3jo6LCwjvo5F711t505LJQ5eTzo1hJjFr5aExuZwHPxMMavZ+ag4r4XyMZrmWzrQs2sroWdEn5u1PhZN39RndT10vsN7H39tNqHNWx00MobqMuBtRE+CIkfi/3gPWoABwUZnvaL92xc+2nhZDS4SIiM4T0TpoWuVU8PmtCTGF3eByUhB4WPvcJBSO9BGAbp2Bu0Cr7WcOvA1PpZDZvt4fcKU+LsDXkenM75eBAFusXPQeMRWM9Q1mmFg5L4OXg4COn4QkLPz6sGDrqZa+F04NHEacv4PqHnV0dHx2mDg6JRWziofJ3OuMqbkB0dHnqj6Oj4AkVv3B0dHR1fIOhmTMc6MXfdqq0f3KtJjd5uZkbPzI4p2I8lXC1+1r3eLrMYe674D3Rb3QvmFjh9j5ticD7t9YEIpyMOYv7o8oP4vRfxyrizZ/TVkDleLFMWOq51H091oHCowe/Yir2OY5f2qyCsuKMKdBCFgYU5+Ww96WTKqSZZ//KIpxYhI/1Fh58usDsdFv2MMJJ+xpSJJXRbeNCYq15kynhMPZiElvMAR5+6OjOsQl23JquFWjSmIb+15tl+mQutWsLCcZffa/k0pZLX8qk29tUCfY6cxXd0tl4NXt7WOlp28w41jcJ4ZWOd4TlXvZT5GNWJmoCctY20jk1EiM6ps7SijOru9aJjTBrLX8a0HWOeZJCJi92iSu7RlBpPRhPImvle2URnrmXPYWs5o7F2xlvreY8chlHT5lqRsRyisp6LDx3nhogze9akx6dX/+B8z7h77bZ1OMqsK7qntCLKImMCZOnIQsnG6fEBh5fmQxJnQC2uTA85htco3FzldlXAmAYnMXcnmo13Tv8R1l1/sp1rulPMqJReBnmmaG0MrJbhcwgJHU+k3Vj+srxMRVazm5sXmeYWHuaKN1tBD6pwtviKtB3G2DI+SGmfA1ZeeUrLXPXTpKNt/ZaeYEyhjO0Vx/ZSGR5r8dfU7VZ1PDL9M2Hn6q0PIubSkGr55HXMMNzH0B8Tbt1lG5mcUb2eEl9r+L0Q9Ct1bEP8iHosiynPfObf2YQs4E/GaDpjBK4HmRHWjfT6t1eYliYVgTWgFtTyMxLe+ntUpi1xR3nlxVmjv0A9rWPyT8fnWSW6AVr8SL+Rnyj+Wnl5fnVe1cJbNCwFxCoDK4/GxG3x0EK35r9WZzzN8sofG44HrdVkTZFIZa0Nqi4cP57/FnjpyvIpv3GYrCmdpVFDRhuF8y2iyWGifIg0l5bvkmbUMHV+ZjU6r87WEAlGK99b8s2qDzVN0KtfXpqitmMNLeiwWWSHmGptzKLn0dfhW/PUBQvAmjCw3L1KmRECNQFj9UK1wtdxRxU1qgw1nrMdQFQRaw0kUx7et0z5Wf70dy+c9J/p0DQPmm5NuEWN1cqLTKOJ8r+lg9dxaD9WHkWC3qOX4SuL1vYcxZ/Nu2y9rIXxvkedk/69SwPcFB49RllI1hKs1WnJhIZkykuspT3ob9I9W0EizSCrldUKIOogWjTcmtDNNIxaA2MaspwlWjVVL4zVqUHEy9+9ehUJvCnCIdPJeOnPCIYoXFYwW8iWi6eVye+Sr1b6NbQK76rgEt/H1sslgAULQBmpFUAyFkVaU9Mtv1Pdp6KVbiZtc8VfaxCRluyFycZfS+eYfKs1who9q8PJdp7aHep7pLXC+ebxmBVKNVpRGEvjgfhe4yXSjq3vHg0vXzJKxlxaraSZxS4BeKUj/IwF/AqVkdqROTDGb4umoHnMVBIdV8ZdQ2rF2QYuw2b48vIuyodsA9JhLL4ylT1Dq9aBRsIooufxYYX33KwwmreM1l6rxy1CwdIirW86rui3Dm/F2eLfQ62cozzxZEPUiZkatycAa0xHDEdCbQxd7c9DLa5s76AzKeqtaoLC81NDVA7ZClyjE/nTv2uaps6j2v8aHwsAOyreqQ1Oh2lpYBmatQ4/K+Sm8GK1wxa+WrWoLD/8zvFlO4pWdxlvioYUgHOqo2OQid8SRmMFbhQmEgCR9pTNQ6uiWcJC+3V7siBeT4B4lb2msY4RDjpeyZcVxvPrxZvhdUr9bk2z5Avqt+5ILH9T+Kh1Vlk6cyDSQPk9u+vLoytpZjv7K+l4g95ZYpY/j16Ndq0By3ctnLzwXqPQYT2Nlp8dFbfFU4YHKUSjfKrl31L9r4Xx+IqEsFcnZIW18kLzZqV5x4hX8+p1dpZ27aXdqicRrPyIwlrp5c5D+7Hy1etovPqRsYhqdSKqJ2O0v4hHr25Iv2NkT03Ae7wx7SvrE1foVkQm3hgNqVbQlp+IF/2tlsker1lEGpnXaK3CbzFBIg04k14dV6R9Zk28iFdPo43SYPGo467lmZX/kSCJNEaP72ydjtISwapfFk0rLi9MJn7Pb0tY73fEr1XnvLoa8RBhCfizwK3qcSSFx6BWsSKJXwtTa8jazWqIDE8wRMgWasaskzQyHU32exZRIx9Lv9ZJetZDixAc64/jqJltUYda6xg9Py35mqnPnr8MMmU0ti1m46m1gQxvy4V2MIhkmdAR1RjSNLKFnRWAGaEnkello14tq7V6afToZHi3aI8VgC15KHnJaLyRm3T36EXCfozgzPr1tBPArhMW35FA8sJFvHnCxvMX8R/BSkcUt+dX81RTHjLhavzU0tLR0dHR0dHR0dHR0dHR0dHR0dHR0dHR0dHR0dHR0dHR0dHR0dHR0dHR0dHR0dHR0dHR0dHR0dHR0dHR0dHR0dHR0dHR0XEg8P8BFzEw7On9a8YAAAAASUVORK5CYII=" alt="PedreiraaTech">
    <h1>Mando Rally</h1>
    <p>PedreiraaTech Solutions &middot; ESP32-C3</p>
  </header>

  <div class="card">
    <h2>Nombre del mando</h2>
    <p class="desc">Como aparece al buscarlo por Bluetooth desde la tablet. Cambiarlo reinicia el mando.</p>
    <input type="text" id="nameInput" maxlength="20" placeholder="Mando Rally Final">
    <button class="btn btn-primary" id="saveNameBtn">Guardar y reiniciar</button>
  </div>

  <div class="card">
    <h2>Perfiles de botones</h2>
    <p class="desc">Tienes 3 perfiles guardados, cada uno con su nombre. El perfil activo es el que usa el mando ahora mismo. Las teclas multimedia (musica) siempre funcionan; las de teclado normal pueden no funcionar en todos los dispositivos.</p>
    <div class="profile-tabs" id="profileTabs"></div>
    <input type="text" id="profileNameInput" maxlength="20" placeholder="Nombre del perfil">
    <div class="slots" id="slots"></div>
    <div class="profile-actions">
      <button class="btn btn-primary" id="saveProfileBtn">Guardar perfil</button>
      <button class="btn btn-secondary" id="useProfileBtn">Usar este perfil ahora</button>
    </div>
  </div>

  <div class="card">
    <h2>Actualizar firmware</h2>
    <p class="desc">Sube un archivo .bin exportado desde Arduino IDE para actualizar el mando sin cables.</p>
    <div class="dropzone" id="dropzone">
      <strong>Toca para elegir archivo</strong>
      <p>o arrastralo aqui &middot; formato .bin</p>
      <div class="filename" id="filename"></div>
    </div>
    <input type="file" id="fileInput" accept=".bin">
    <div class="progress-wrap" id="progressWrap"><div class="progress-bar" id="progressBar"></div></div>
    <div class="status" id="otaStatus"></div>
    <button class="btn btn-primary" id="uploadBtn" disabled>Subir y actualizar</button>
  </div>

  <div class="card">
    <h2>Mando</h2>
    <p class="desc">Sal del modo actualizacion y vuelve al funcionamiento normal por Bluetooth.</p>
    <button class="btn btn-secondary" id="restartBtn">Reiniciar mando</button>
  </div>

  <footer>
    Conectado a MandoRally-Update &middot; 192.168.4.1<br>
    Creado por @PedreiraTechSolutions
  </footer>
</div>
<div class="toast" id="toast"></div>

<script>
// Catalogo de teclas asignables. Las de grupo "musica" son las que hemos
// comprobado que siempre funcionan por Bluetooth; las de "teclado" pueden
// no funcionar en todos los dispositivos.
const KEY_CATALOG = [
  {v:0,  label:"(ninguna)", group:"otro"},
  {v:1,  label:"Play / Pausa", group:"musica"},
  {v:2,  label:"Volumen +", group:"musica"},
  {v:3,  label:"Volumen -", group:"musica"},
  {v:4,  label:"Siguiente cancion", group:"musica"},
  {v:5,  label:"Cancion anterior", group:"musica"},
  {v:6,  label:"Silencio (mute)", group:"musica"},
  {v:7,  label:"Stop", group:"musica"},
  {v:50, label:"Enter", group:"teclado"},
  {v:51, label:"Espacio", group:"teclado"},
  {v:52, label:"Escape", group:"teclado"},
  {v:53, label:"Retroceso", group:"teclado"},
  {v:54, label:"Tab", group:"teclado"},
  {v:55, label:"Flecha arriba", group:"teclado"},
  {v:56, label:"Flecha abajo", group:"teclado"},
  {v:57, label:"Flecha izquierda", group:"teclado"},
  {v:58, label:"Flecha derecha", group:"teclado"},
];
for(let i=0;i<26;i++){
  KEY_CATALOG.push({v:10+i, label:"Letra "+String.fromCharCode(65+i), group:"teclado"});
}
for(let i=0;i<10;i++){
  KEY_CATALOG.push({v:40+i, label:"Numero "+i, group:"teclado"});
}
const GROUP_LABELS = {musica:"Multimedia (recomendado)", teclado:"Teclado", otro:""};

const PHYS_LABELS = ["Boton 1 (arriba)","Boton 2","Boton 3","Palanca abajo","Palanca arriba"];
const NUM_PERFILES = 3;

let perfiles = [];      // [{nombre, teclas:[..5..]}, ...] x3
let perfilActivoServidor = 0;
let perfilSeleccionado = 0;

function toast(msg, isErr){
  const t = document.getElementById('toast');
  t.textContent = msg;
  t.style.background = isErr ? 'rgba(255,59,48,0.95)' : 'rgba(28,28,30,0.92)';
  t.classList.add('show');
  clearTimeout(toast._t);
  toast._t = setTimeout(()=>t.classList.remove('show'), 2200);
}

function buildProfileTabs(){
  const cont = document.getElementById('profileTabs');
  cont.innerHTML = '';
  for(let p=0;p<NUM_PERFILES;p++){
    const tab = document.createElement('div');
    tab.className = 'profile-tab' + (p===perfilSeleccionado ? ' active' : '');
    tab.textContent = perfiles[p].nombre + (p===perfilActivoServidor ? ' ●' : '');
    tab.addEventListener('click', ()=>seleccionarPerfil(p));
    cont.appendChild(tab);
  }
}

function seleccionarPerfil(p){
  perfilSeleccionado = p;
  document.getElementById('profileNameInput').value = perfiles[p].nombre;
  buildProfileTabs();
  buildSlots();
}

function buildSlots(){
  const cont = document.getElementById('slots');
  cont.innerHTML = '';
  const teclas = perfiles[perfilSeleccionado].teclas;
  for(let i=0;i<5;i++){
    const row = document.createElement('div');
    row.className = 'slot-row';
    const name = document.createElement('div');
    name.className = 'name';
    name.textContent = PHYS_LABELS[i];
    const sel = document.createElement('select');
    sel.id = 'slot'+i;
    let grupoActual = null;
    KEY_CATALOG.forEach(o=>{
      if(o.group !== grupoActual && o.group !== 'otro'){
        grupoActual = o.group;
        const og = document.createElement('optgroup');
        og.label = GROUP_LABELS[o.group];
        og.dataset.group = o.group;
        sel.appendChild(og);
      }
      const opt = document.createElement('option');
      opt.value = o.v; opt.textContent = o.label;
      (sel.querySelector('optgroup[data-group="'+o.group+'"]') || sel).appendChild(opt);
    });
    sel.value = teclas[i];
    sel.addEventListener('change', ()=>{ teclas[i] = parseInt(sel.value); });
    row.appendChild(name); row.appendChild(sel);
    cont.appendChild(row);
  }
}

async function cargarPerfiles(){
  try{
    const res = await fetch('/api/profiles');
    const text = await res.text();
    const p = new URLSearchParams(text);
    perfilActivoServidor = parseInt(p.get('active')) || 0;
    perfiles = [];
    for(let n=0;n<NUM_PERFILES;n++){
      const nombre = decodeURIComponent((p.get('p'+n+'nom')||('Perfil '+(n+1))).replace(/\+/g,' '));
      const teclas = [];
      for(let i=0;i<5;i++){
        teclas.push(parseInt(p.get('p'+n+'_'+i)) || 0);
      }
      perfiles.push({nombre, teclas});
    }
    perfilSeleccionado = perfilActivoServidor;
    document.getElementById('profileNameInput').value = perfiles[perfilSeleccionado].nombre;
    buildProfileTabs();
    buildSlots();
  }catch(e){
    toast('No se pudo cargar la configuracion', true);
  }
}

document.getElementById('saveProfileBtn').addEventListener('click', async ()=>{
  const nombre = document.getElementById('profileNameInput').value.trim() || ('Perfil '+(perfilSeleccionado+1));
  perfiles[perfilSeleccionado].nombre = nombre;
  const teclas = perfiles[perfilSeleccionado].teclas;
  const body = 'perfil='+perfilSeleccionado+'&nombre='+encodeURIComponent(nombre)+
    '&k0='+teclas[0]+'&k1='+teclas[1]+'&k2='+teclas[2]+'&k3='+teclas[3]+'&k4='+teclas[4];
  try{
    const res = await fetch('/api/profile', {
      method:'POST',
      headers:{'Content-Type':'application/x-www-form-urlencoded'},
      body
    });
    if(res.ok){ toast('Perfil guardado'); buildProfileTabs(); } else { toast('Error al guardar', true); }
  }catch(e){ toast('Sin conexion con el mando', true); }
});

document.getElementById('useProfileBtn').addEventListener('click', async ()=>{
  try{
    const res = await fetch('/api/activeprofile', {
      method:'POST',
      headers:{'Content-Type':'application/x-www-form-urlencoded'},
      body: 'perfil='+perfilSeleccionado
    });
    if(res.ok){
      perfilActivoServidor = perfilSeleccionado;
      buildProfileTabs();
      toast('Perfil activo: ' + perfiles[perfilSeleccionado].nombre);
    } else { toast('Error al activar', true); }
  }catch(e){ toast('Sin conexion con el mando', true); }
});

async function cargarNombre(){
  try{
    const res = await fetch('/api/name');
    const text = await res.text();
    document.getElementById('nameInput').value = text;
  }catch(e){}
}

document.getElementById('saveNameBtn').addEventListener('click', async ()=>{
  const val = document.getElementById('nameInput').value.trim();
  if(!val){ toast('Escribe un nombre', true); return; }
  toast('Guardando y reiniciando...');
  try{
    await fetch('/api/name', {
      method:'POST',
      headers:{'Content-Type':'application/x-www-form-urlencoded'},
      body: 'name=' + encodeURIComponent(val)
    });
  }catch(e){}
});

const dropzone = document.getElementById('dropzone');
const fileInput = document.getElementById('fileInput');
const uploadBtn = document.getElementById('uploadBtn');
const filenameEl = document.getElementById('filename');
let selectedFile = null;

dropzone.addEventListener('click', ()=>fileInput.click());
['dragover','dragenter'].forEach(ev=>dropzone.addEventListener(ev, e=>{e.preventDefault(); dropzone.classList.add('drag');}));
['dragleave','drop'].forEach(ev=>dropzone.addEventListener(ev, e=>{e.preventDefault(); dropzone.classList.remove('drag');}));
dropzone.addEventListener('drop', e=>{
  if(e.dataTransfer.files.length){ setFile(e.dataTransfer.files[0]); }
});
fileInput.addEventListener('change', ()=>{
  if(fileInput.files.length){ setFile(fileInput.files[0]); }
});
function setFile(f){
  selectedFile = f;
  filenameEl.textContent = f.name;
  uploadBtn.disabled = false;
}

uploadBtn.addEventListener('click', ()=>{
  if(!selectedFile) return;
  const statusEl = document.getElementById('otaStatus');
  const wrap = document.getElementById('progressWrap');
  const bar = document.getElementById('progressBar');
  statusEl.textContent = ''; statusEl.className = 'status';
  wrap.style.display = 'block'; bar.style.width = '0%';
  uploadBtn.disabled = true;

  const fd = new FormData();
  fd.append('update', selectedFile);
  const xhr = new XMLHttpRequest();
  xhr.open('POST', '/update', true);
  xhr.upload.onprogress = (e)=>{
    if(e.lengthComputable){ bar.style.width = Math.round(e.loaded/e.total*100)+'%'; }
  };
  xhr.onload = ()=>{
    if(xhr.status === 200 && !xhr.responseText.toLowerCase().includes('error')){
      statusEl.textContent = 'Actualizado. Reiniciando...';
      statusEl.classList.add('ok');
    } else {
      statusEl.textContent = 'Error al actualizar: '+xhr.responseText;
      statusEl.classList.add('err');
      uploadBtn.disabled = false;
    }
  };
  xhr.onerror = ()=>{
    statusEl.textContent = 'Fallo de conexion durante la subida';
    statusEl.classList.add('err');
    uploadBtn.disabled = false;
  };
  xhr.send(fd);
});

document.getElementById('restartBtn').addEventListener('click', async ()=>{
  toast('Reiniciando mando...');
  try{ await fetch('/api/restart', {method:'POST'}); }catch(e){}
});

cargarPerfiles();
cargarNombre();
</script>
</body>
</html>

)HTMLPAGE";

// ======================= UTILIDADES DE CONFIG =======================

// Codifica un texto para poder mandarlo dentro de una respuesta
// application/x-www-form-urlencoded (usado para los nombres de perfil,
// que pueden llevar espacios u otros caracteres).
String urlEncode(const String& str) {
  String encoded = "";
  char buf[4];
  for (size_t i = 0; i < str.length(); i++) {
    char c = str.charAt(i);
    if (isalnum((unsigned char)c) || c == '-' || c == '_' || c == '.' || c == '~') {
      encoded += c;
    } else {
      sprintf(buf, "%%%02X", (unsigned char)c);
      encoded += buf;
    }
  }
  return encoded;
}

void cargarConfig() {
  prefs.begin("mando", false);
  perfilActivo = prefs.getInt("perfilActivo", 0);
  if (perfilActivo < 0 || perfilActivo >= NUM_PERFILES) perfilActivo = 0;
  for (int p = 0; p < NUM_PERFILES; p++) {
    perfilNombre[p] = prefs.getString(("pnom" + String(p)).c_str(), "Perfil " + String(p + 1));
    for (int i = 0; i < 5; i++) {
      int porDefecto = i + 1; // 1..5 = mapeo clasico de musica
      botonKeyId[p][i] = prefs.getInt(("pk" + String(p) + "_" + String(i)).c_str(), porDefecto);
    }
  }
  btDeviceName = prefs.getString("btName", "Mando Rally Final");
  prefs.end();
}

// Guarda un unico perfil (nombre + 5 teclas). No toca los otros perfiles.
void guardarPerfil(int p) {
  prefs.begin("mando", false);
  prefs.putString(("pnom" + String(p)).c_str(), perfilNombre[p]);
  for (int i = 0; i < 5; i++) {
    prefs.putInt(("pk" + String(p) + "_" + String(i)).c_str(), botonKeyId[p][i]);
  }
  prefs.end();
}

void guardarPerfilActivo() {
  prefs.begin("mando", false);
  prefs.putInt("perfilActivo", perfilActivo);
  prefs.end();
}

// ======================= CATALOGO DE TECLAS =======================
// id 0        = ninguna accion
// id 1-7      = multimedia (usan el usage page "Consumer Control": son las
//               que hemos comprobado que SIEMPRE funcionan por Bluetooth)
// id 10-35    = letras a-z
// id 40-49    = digitos 0-9
// id 50-58    = teclas especiales de teclado normal (Enter, flechas, etc.)
//               OJO: estas usan el teclado "normal" (usage page Keyboard),
//               que en este mando en concreto hemos comprobado que NO
//               siempre llega al dispositivo (a diferencia de las
//               multimedia). Se dejan disponibles por si en otro
//               dispositivo si funcionan, pero no son fiables al 100%.
void enviarAccion(int keyId) {
  if (keyId == 0) return; // ninguna accion asignada a este boton

  if (keyId >= 10 && keyId <= 35) {
    bleKeyboard->write((char)('a' + (keyId - 10)));
    delay(60);
    return;
  }
  if (keyId >= 40 && keyId <= 49) {
    bleKeyboard->write((char)('0' + (keyId - 40)));
    delay(60);
    return;
  }

  switch (keyId) {
    case 1: bleKeyboard->write(KEY_MEDIA_PLAY_PAUSE); break;
    case 2: bleKeyboard->write(KEY_MEDIA_VOLUME_UP); break;
    case 3: bleKeyboard->write(KEY_MEDIA_VOLUME_DOWN); break;
    case 4: bleKeyboard->write(KEY_MEDIA_NEXT_TRACK); break;
    case 5: bleKeyboard->write(KEY_MEDIA_PREVIOUS_TRACK); break;
    case 6: bleKeyboard->write(KEY_MEDIA_MUTE); break;
    case 7: bleKeyboard->write(KEY_MEDIA_STOP); break;
    case 50: bleKeyboard->write(KEY_RETURN); break;
    case 51: bleKeyboard->write(' '); break;
    case 52: bleKeyboard->write(KEY_ESC); break;
    case 53: bleKeyboard->write(KEY_BACKSPACE); break;
    case 54: bleKeyboard->write(KEY_TAB); break;
    case 55: bleKeyboard->write(KEY_UP_ARROW); break;
    case 56: bleKeyboard->write(KEY_DOWN_ARROW); break;
    case 57: bleKeyboard->write(KEY_LEFT_ARROW); break;
    case 58: bleKeyboard->write(KEY_RIGHT_ARROW); break;
  }
  delay(60);
}

// ======================= MODO ACTUALIZACION (WIFI + WEB) =======================

void iniciarModoOTA() {
  Serial.println(">>> Entrando en MODO ACTUALIZACION (WiFi) <<<");
  modoOtaActivo = true;
  otaModoInicio = millis();

  btStop();  // Apaga el Bluetooth por completo para liberar la radio para el WiFi
  delay(200);

  WiFi.mode(WIFI_AP);
  bool apOk = WiFi.softAP(OTA_SSID, OTA_PASS);
  WiFi.setTxPower(WIFI_POWER_19_5dBm); // potencia maxima permitida, mas alcance
  Serial.print("Punto de acceso creado: ");
  Serial.println(apOk ? "SI" : "NO (fallo)");
  Serial.print("Red WiFi creada: ");
  Serial.println(OTA_SSID);
  Serial.print("Abre en el navegador: http://");
  Serial.println(WiFi.softAPIP());

  // --- Pagina principal ---
  server.on("/", HTTP_GET, []() {
    server.send_P(200, "text/html", PAGE_HTML);
  });

  // --- API: leer los 3 perfiles completos + cual esta activo ---
  server.on("/api/profiles", HTTP_GET, []() {
    String resp = "active=" + String(perfilActivo);
    for (int p = 0; p < NUM_PERFILES; p++) {
      resp += "&p" + String(p) + "nom=" + urlEncode(perfilNombre[p]);
      for (int i = 0; i < 5; i++) {
        resp += "&p" + String(p) + "_" + String(i) + "=" + String(botonKeyId[p][i]);
      }
    }
    server.send(200, "text/plain", resp);
  });

  // --- API: guardar UN perfil (nombre + las 5 teclas) ---
  server.on("/api/profile", HTTP_POST, []() {
    if (!server.hasArg("perfil")) {
      server.send(400, "text/plain", "Falta el numero de perfil");
      return;
    }
    int p = server.arg("perfil").toInt();
    if (p < 0 || p >= NUM_PERFILES) {
      server.send(400, "text/plain", "Perfil invalido");
      return;
    }
    int nuevo[5];
    for (int i = 0; i < 5; i++) {
      String key = "k" + String(i);
      if (!server.hasArg(key)) {
        server.send(400, "text/plain", "Falta la tecla del boton " + String(i));
        return;
      }
      nuevo[i] = server.arg(key).toInt();
    }
    String nombre = perfilNombre[p];
    if (server.hasArg("nombre")) {
      nombre = server.arg("nombre");
      nombre.trim();
      if (nombre.length() < 1) nombre = "Perfil " + String(p + 1);
      if (nombre.length() > 20) nombre = nombre.substring(0, 20);
    }
    perfilNombre[p] = nombre;
    for (int i = 0; i < 5; i++) botonKeyId[p][i] = nuevo[i];

    guardarPerfil(p);
    server.send(200, "text/plain", "OK");
  });

  // --- API: cambiar cual es el perfil activo (se aplica al momento) ---
  server.on("/api/activeprofile", HTTP_POST, []() {
    if (!server.hasArg("perfil")) {
      server.send(400, "text/plain", "Falta el numero de perfil");
      return;
    }
    int p = server.arg("perfil").toInt();
    if (p < 0 || p >= NUM_PERFILES) {
      server.send(400, "text/plain", "Perfil invalido");
      return;
    }
    perfilActivo = p;
    guardarPerfilActivo();
    server.send(200, "text/plain", "OK");
  });

  // --- API: leer el nombre Bluetooth actual ---
  server.on("/api/name", HTTP_GET, []() {
    server.send(200, "text/plain", btDeviceName);
  });

  // --- API: cambiar el nombre Bluetooth (requiere reinicio) ---
  server.on("/api/name", HTTP_POST, []() {
    if (!server.hasArg("name")) {
      server.send(400, "text/plain", "Falta el nombre");
      return;
    }
    String nuevo = server.arg("name");
    nuevo.trim();
    if (nuevo.length() < 1 || nuevo.length() > 20) {
      server.send(400, "text/plain", "Nombre invalido (1-20 caracteres)");
      return;
    }
    prefs.begin("mando", false);
    prefs.putString("btName", nuevo);
    prefs.end();
    server.send(200, "text/plain", "OK, reiniciando...");
    delay(400);
    ESP.restart();
  });

  // --- API: reiniciar el mando (vuelve a modo Bluetooth normal) ---
  server.on("/api/restart", HTTP_POST, []() {
    server.send(200, "text/plain", "Reiniciando...");
    delay(300);
    ESP.restart();
  });

  // --- OTA: subida de firmware ---
  server.on("/update", HTTP_POST, []() {
    server.send(200, "text/plain", (Update.hasError()) ? "ERROR al actualizar" : "Actualizacion OK, reiniciando...");
    delay(1000);
    ESP.restart();
  }, []() {
    HTTPUpload& upload = server.upload();
    if (upload.status == UPLOAD_FILE_START) {
      Serial.printf("Actualizando: %s\n", upload.filename.c_str());
      if (!Update.begin(UPDATE_SIZE_UNKNOWN)) {
        Update.printError(Serial);
      }
    } else if (upload.status == UPLOAD_FILE_WRITE) {
      if (Update.write(upload.buf, upload.currentSize) != upload.currentSize) {
        Update.printError(Serial);
      }
    } else if (upload.status == UPLOAD_FILE_END) {
      if (Update.end(true)) {
        Serial.printf("Actualizado correctamente: %u bytes\n", upload.totalSize);
      } else {
        Update.printError(Serial);
      }
    }
  });

  server.begin();
}

// ======================= SETUP =======================

void setup() {
  Serial.begin(115200);
  Serial.println("Iniciando Mando Rally ESP32-C3...");

  for (int i = 0; i < 5; i++) {
    pinMode(PHYSICAL_PINS[i], INPUT_PULLUP);
  }

  cargarConfig();

  // Cambiamos la direccion MAC de Bluetooth para que cualquier movil/tablet
  // que se haya conectado antes a este ESP32 (con firmwares anteriores) lo
  // vea como un dispositivo completamente nuevo, sin ninguna tabla de
  // caracteristicas guardada en cache de versiones anteriores.
  uint8_t nuevaMac[6] = {0x02, 0xAB, 0xCD, 0x12, 0x34, 0x57};
  esp_base_mac_addr_set(nuevaMac);

  bleKeyboard = new BleKeyboard(btDeviceName.c_str(), "PedreiraTech", 100);
  bleKeyboard->begin();

  // Subimos la potencia de emision del Bluetooth al maximo permitido, para
  // mas alcance y una conexion mas estable (menos cortes por señal debil).
  esp_ble_tx_power_set(ESP_BLE_PWR_TYPE_DEFAULT, ESP_PWR_LVL_P9);
  esp_ble_tx_power_set(ESP_BLE_PWR_TYPE_ADV, ESP_PWR_LVL_P9);
  esp_ble_tx_power_set(ESP_BLE_PWR_TYPE_CONN_HDL0, ESP_PWR_LVL_P9);

  esp_ble_auth_req_t auth_req = ESP_LE_AUTH_BOND;
  esp_ble_io_cap_t iocap = ESP_IO_CAP_NONE;
  uint8_t key_size = 16;
  uint8_t init_key = ESP_BLE_ENC_KEY_MASK | ESP_BLE_ID_KEY_MASK;
  uint8_t rsp_key  = ESP_BLE_ENC_KEY_MASK | ESP_BLE_ID_KEY_MASK;

  esp_ble_gap_set_security_param(ESP_BLE_SM_AUTHEN_REQ_MODE, &auth_req, sizeof(uint8_t));
  esp_ble_gap_set_security_param(ESP_BLE_SM_IOCAP_MODE, &iocap, sizeof(uint8_t));
  esp_ble_gap_set_security_param(ESP_BLE_SM_MAX_KEY_SIZE, &key_size, sizeof(uint8_t));
  esp_ble_gap_set_security_param(ESP_BLE_SM_SET_INIT_KEY, &init_key, sizeof(uint8_t));
  esp_ble_gap_set_security_param(ESP_BLE_SM_SET_RSP_KEY, &rsp_key, sizeof(uint8_t));

  Serial.println("Seguridad Bluedroid configurada, esperando conexiones...");
}

// ======================= LOOP =======================

void loop() {
  // --- Si ya estamos en modo actualizacion, solo atendemos peticiones web ---
  if (modoOtaActivo) {
    server.handleClient();

    // Salida manual: mantener Boton1+Palanca abajo pulsados 3s reinicia
    // y vuelve al modo Bluetooth normal, sin depender de la web ni del reset fisico
    bool s0 = (digitalRead(PHYSICAL_PINS[0]) == LOW);
    bool s3 = (digitalRead(PHYSICAL_PINS[3]) == LOW);
    if (s0 && s3) {
      if (!salirOtaEnCurso) {
        salirOtaEnCurso = true;
        salirOtaInicio = millis();
      }
      salirOtaUltimoOk = millis();
      if (millis() - salirOtaInicio >= TIEMPO_SALIR_OTA) {
        Serial.println(">>> Saliendo de modo actualizacion (combo), reiniciando... <<<");
        ESP.restart();
      }
    } else if (salirOtaEnCurso && (millis() - salirOtaUltimoOk > TOLERANCIA_COMBO)) {
      salirOtaEnCurso = false;
    }

    // Salida automatica: si nadie se conecta a la red en 10 minutos, reinicia solo
    if (WiFi.softAPgetStationNum() == 0 && (millis() - otaModoInicio) >= TIEMPO_LIMITE_OTA) {
      Serial.println(">>> Nadie conectado tras 10 min, saliendo de modo actualizacion... <<<");
      ESP.restart();
    }

    return;
  }

  bool p[5];
  for (int i = 0; i < 5; i++) p[i] = (digitalRead(PHYSICAL_PINS[i]) == LOW);

  // --- Combo Boton1+Palanca abajo mantenido 5s: entra en modo actualizacion ---
  // (con margen de tolerancia: un pequeño desajuste al pulsar los dos
  // botones, o soltar un instante, no reinicia la cuenta atras)
  if (p[0] && p[3] && !p[4]) {
    if (!comboOtaEnCurso) {
      comboOtaEnCurso = true;
      comboOtaInicio = millis();
    }
    comboOtaUltimoOk = millis();
    if (millis() - comboOtaInicio >= TIEMPO_COMBO) {
      iniciarModoOTA();
      return;
    }
    delay(10);
    return;
  } else if (comboOtaEnCurso) {
    if (millis() - comboOtaUltimoOk > TOLERANCIA_COMBO) {
      comboOtaEnCurso = false;
    } else {
      delay(10);
      return;
    }
  }

  if (!bleKeyboard->isConnected()) {
    delay(10);
    return;
  }

  // --- Combo Boton1+Palanca arriba mantenido 5s: reinicia el mando ---
  if (p[0] && p[4] && !p[3]) {
    if (!comboRebootEnCurso) {
      comboRebootEnCurso = true;
      comboRebootInicio = millis();
    }
    comboRebootUltimoOk = millis();
    if (millis() - comboRebootInicio >= TIEMPO_COMBO) {
      Serial.println(">>> Combo de reinicio detectado, reiniciando... <<<");
      ESP.restart();
    }
    delay(10);
    return;
  } else if (comboRebootEnCurso) {
    if (millis() - comboRebootUltimoOk > TOLERANCIA_COMBO) {
      comboRebootEnCurso = false;
    } else {
      delay(10);
      return;
    }
  }

  static unsigned long ultimoDebug = 0;
  if (millis() - ultimoDebug > 1000) {
    ultimoDebug = millis();
    Serial.printf("Conectado: %d | Pines: %d %d %d %d %d\n",
      bleKeyboard->isConnected(), p[0], p[1], p[2], p[3], p[4]);
  }

  for (int i = 0; i < 5; i++) {
    if (p[i]) {
      Serial.printf(">>> Pulsado fisico %d -> tecla id %d (perfil %d)\n", i, botonKeyId[perfilActivo][i], perfilActivo);
      enviarAccion(botonKeyId[perfilActivo][i]);
    }
  }

  delay(10);
}
